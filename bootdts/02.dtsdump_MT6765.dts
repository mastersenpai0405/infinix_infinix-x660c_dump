/dts-v1/;

/ {
	model = "MT6765";
	compatible = "mediatek,MT6765";
	interrupt-parent = <0x01>;
	#address-cells = <0x02>;
	#size-cells = <0x02>;

	chosen {
		bootargs = "console=tty0 console=ttyS0,921600n1 vmalloc=400M \t\t\t\tslub_debug=OFZPU page_owner=on \t\t\t\tswiotlb=noforce androidboot.hardware=mt6765 \t\t\t\tmaxcpus=8 loop.max_part=7 \t\t\t\tfirmware_class.path=/vendor/firmware";
		kaslr-seed = <0x00 0x00>;
		linux,phandle = <0x4c>;
		phandle = <0x4c>;
	};

	cpus {
		#address-cells = <0x01>;
		#size-cells = <0x00>;

		cpu@000 {
			device_type = "cpu";
			compatible = "arm,cortex-a53";
			reg = <0x00>;
			enable-method = "psci";
			clock-frequency = <0x89267940>;
			cpu-idle-states = <0x02 0x03 0x04 0x05 0x06 0x07 0x08>;
			linux,phandle = <0x09>;
			phandle = <0x09>;
		};

		cpu@001 {
			device_type = "cpu";
			compatible = "arm,cortex-a53";
			reg = <0x01>;
			enable-method = "psci";
			clock-frequency = <0x89267940>;
			cpu-idle-states = <0x02 0x03 0x04 0x05 0x06 0x07 0x08>;
			linux,phandle = <0x0a>;
			phandle = <0x0a>;
		};

		cpu@002 {
			device_type = "cpu";
			compatible = "arm,cortex-a53";
			reg = <0x02>;
			enable-method = "psci";
			clock-frequency = <0x89267940>;
			cpu-idle-states = <0x02 0x03 0x04 0x05 0x06 0x07 0x08>;
			linux,phandle = <0x0b>;
			phandle = <0x0b>;
		};

		cpu@003 {
			device_type = "cpu";
			compatible = "arm,cortex-a53";
			reg = <0x03>;
			enable-method = "psci";
			clock-frequency = <0x89267940>;
			cpu-idle-states = <0x02 0x03 0x04 0x05 0x06 0x07 0x08>;
			linux,phandle = <0x0c>;
			phandle = <0x0c>;
		};

		cpu@100 {
			device_type = "cpu";
			compatible = "arm,cortex-a53";
			reg = <0x100>;
			enable-method = "psci";
			clock-frequency = <0x6b49d200>;
			cpu-idle-states = <0x02 0x03 0x04 0x05 0x06 0x07 0x08>;
			linux,phandle = <0x0d>;
			phandle = <0x0d>;
		};

		cpu@101 {
			device_type = "cpu";
			compatible = "arm,cortex-a53";
			reg = <0x101>;
			enable-method = "psci";
			clock-frequency = <0x6b49d200>;
			cpu-idle-states = <0x02 0x03 0x04 0x05 0x06 0x07 0x08>;
			linux,phandle = <0x0e>;
			phandle = <0x0e>;
		};

		cpu@102 {
			device_type = "cpu";
			compatible = "arm,cortex-a53";
			reg = <0x102>;
			enable-method = "psci";
			clock-frequency = <0x6b49d200>;
			cpu-idle-states = <0x02 0x03 0x04 0x05 0x06 0x07 0x08>;
			linux,phandle = <0x0f>;
			phandle = <0x0f>;
		};

		cpu@103 {
			device_type = "cpu";
			compatible = "arm,cortex-a53";
			reg = <0x103>;
			enable-method = "psci";
			clock-frequency = <0x6b49d200>;
			cpu-idle-states = <0x02 0x03 0x04 0x05 0x06 0x07 0x08>;
			linux,phandle = <0x10>;
			phandle = <0x10>;
		};

		cpu-map {

			cluster0 {

				core0 {
					cpu = <0x09>;
				};

				core1 {
					cpu = <0x0a>;
				};

				core2 {
					cpu = <0x0b>;
				};

				core3 {
					cpu = <0x0c>;
				};
			};

			cluster1 {

				core0 {
					cpu = <0x0d>;
				};

				core1 {
					cpu = <0x0e>;
				};

				core2 {
					cpu = <0x0f>;
				};

				core3 {
					cpu = <0x10>;
				};
			};
		};

		idle-states {
			entry-method = "arm,psci";

			standby {
				compatible = "arm,idle-state";
				arm,psci-suspend-param = <0x01>;
				entry-latency-us = <0x258>;
				exit-latency-us = <0x258>;
				min-residency-us = <0x4b0>;
				linux,phandle = <0x02>;
				phandle = <0x02>;
			};

			mcdi-cpu {
				compatible = "arm,idle-state";
				arm,psci-suspend-param = <0x10001>;
				entry-latency-us = <0x258>;
				exit-latency-us = <0x258>;
				min-residency-us = <0x4b0>;
				linux,phandle = <0x03>;
				phandle = <0x03>;
			};

			mcdi-cluster {
				compatible = "arm,idle-state";
				arm,psci-suspend-param = <0x1010001>;
				entry-latency-us = <0x258>;
				exit-latency-us = <0x258>;
				min-residency-us = <0x4b0>;
				linux,phandle = <0x04>;
				phandle = <0x04>;
			};

			sodi {
				compatible = "arm,idle-state";
				arm,psci-suspend-param = <0x1010002>;
				entry-latency-us = <0x320>;
				exit-latency-us = <0x3e8>;
				min-residency-us = <0x7d0>;
				linux,phandle = <0x05>;
				phandle = <0x05>;
			};

			sodi3 {
				compatible = "arm,idle-state";
				arm,psci-suspend-param = <0x1010003>;
				entry-latency-us = <0x320>;
				exit-latency-us = <0x3e8>;
				min-residency-us = <0x7d0>;
				linux,phandle = <0x06>;
				phandle = <0x06>;
			};

			dpidle {
				compatible = "arm,idle-state";
				arm,psci-suspend-param = <0x1010004>;
				entry-latency-us = <0x320>;
				exit-latency-us = <0x3e8>;
				min-residency-us = <0x7d0>;
				linux,phandle = <0x07>;
				phandle = <0x07>;
			};

			suspend {
				compatible = "arm,idle-state";
				arm,psci-suspend-param = <0x1010005>;
				entry-latency-us = <0x320>;
				exit-latency-us = <0x3e8>;
				min-residency-us = <0x7d0>;
				linux,phandle = <0x08>;
				phandle = <0x08>;
			};
		};
	};

	psci {
		compatible = "arm,psci-1.0";
		method = "smc";
	};

	pmu {
		compatible = "arm,armv8-pmuv3";
		interrupt-parent = <0x11>;
		interrupts = <0x01 0x07 0x08>;
	};

	l2c_parity {
		compatible = "mediatek,l2c_parity-v1";
		interrupts = <0x00 0x18 0x04 0x00 0x19 0x04>;
	};

	memory {
		device_type = "memory";
		reg = <0x00 0x40000000 0x00 0x20000000>;
	};

	reserved-memory {
		#address-cells = <0x02>;
		#size-cells = <0x02>;
		ranges;
		linux,phandle = <0x4d>;
		phandle = <0x4d>;

		zmc-default {
			compatible = "mediatek,zone_movable_cma";
			size = <0x00 0xffc00000>;
			alignment = <0x00 0x10000000>;
			alloc-ranges = <0x00 0xc0000000 0x01 0x00>;
		};

		reserve-memory-sspm_share {
			compatible = "mediatek,reserve-memory-sspm_share";
			no-map;
			status = "okay";
			size = <0x00 0x510000>;
			alignment = <0x00 0x10000>;
			alloc-ranges = <0x00 0x40000000 0x00 0x60000000>;
		};

		reserve-memory-scp_share {
			compatible = "mediatek,reserve-memory-scp_share";
			no-map;
			size = <0x00 0x300000>;
			alignment = <0x00 0x1000000>;
			alloc-ranges = <0x00 0x40000000 0x00 0x50000000>;
		};

		consys-reserve-memory {
			compatible = "mediatek,consys-reserve-memory";
			no-map;
			size = <0x00 0x400000>;
			alignment = <0x00 0x1000000>;
			alloc-ranges = <0x00 0x40000000 0x00 0x80000000>;
		};

		wifi-reserve-memory {
			compatible = "mediatek,wifi-reserve-memory";
			no-map;
			size = <0x00 0x300000>;
			alignment = <0x00 0x1000000>;
			alloc-ranges = <0x00 0x40000000 0x00 0x80000000>;
		};

		soter-shared-mem {
			compatible = "microtrust,shared_mem";
			no-map;
			size = <0x00 0x200000>;
			alloc-ranges = <0x00 0x40000000 0x00 0x50000000>;
		};
	};

	cpu_dbgapb@0d410000 {
		compatible = "mediatek,hw_dbg";
		num = <0x08>;
		reg = <0x00 0xd410000 0x00 0x1000 0x00 0xd510000 0x00 0x1000 0x00 0xd610000 0x00 0x1000 0x00 0xd710000 0x00 0x1000 0x00 0xd810000 0x00 0x1000 0x00 0xd910000 0x00 0x1000 0x00 0xda10000 0x00 0x1000 0x00 0xdb10000 0x00 0x1000>;
		linux,phandle = <0x4e>;
		phandle = <0x4e>;
	};

	atf_logger {
		compatible = "mediatek,atf_logger";
		interrupts = <0x00 0xf7 0x01>;
	};

	amms_control {
		compatible = "mediatek,amms";
		interrupts = <0x00 0x86 0x01>;
	};

	utos {
		compatible = "microtrust,utos";
		interrupts = <0x00 0xf9 0x01 0x00 0xfa 0x01>;
	};

	utos_tester {
		compatible = "microtrust,tester-v1";
	};

	tkcore {
		compatible = "trustkernel,tkcore";
		interrupts = <0x00 0xf8 0x01>;
	};

	plat_sram_flag@0011db00 {
		compatible = "mediatek,plat_sram_flag";
		reg = <0x00 0x10e5f0 0x00 0x10>;
	};

	interrupt-controller@0c000000 {
		compatible = "arm,gic-v3";
		#interrupt-cells = <0x03>;
		#address-cells = <0x02>;
		#size-cells = <0x02>;
		#redistributor-regions = <0x01>;
		interrupt-parent = <0x11>;
		interrupt-controller;
		reg = <0x00 0xc000000 0x00 0x40000 0x00 0xc100000 0x00 0x200000 0x00 0x10200a80 0x00 0x50>;
		interrupts = <0x01 0x09 0x04>;
		linux,phandle = <0x11>;
		phandle = <0x11>;
	};

	intpol-controller@10200a80 {
		compatible = "mediatek,mt6577-sysirq";
		interrupt-controller;
		#interrupt-cells = <0x03>;
		interrupt-parent = <0x11>;
		reg = <0x00 0x10200a80 0x00 0x50>;
		linux,phandle = <0x01>;
		phandle = <0x01>;
	};

	infracfg_ao@10001000 {
		compatible = "mediatek,infracfg_ao\0syscon";
		reg = <0x00 0x10001000 0x00 0x1000>;
		interrupts = <0x00 0x93 0x01>;
		#clock-cells = <0x01>;
		linux,phandle = <0x24>;
		phandle = <0x24>;
	};

	mcdi@0010fc00 {
		compatible = "mediatek,mt6765-mcdi";
		reg = <0x00 0x10fc00 0x00 0x800>;
	};

	scpsys@10001000 {
		compatible = "mediatek,scpsys\0syscon";
		reg = <0x00 0x10001000 0x00 0x1000 0x00 0x10006000 0x00 0x1000 0x00 0x14002000 0x00 0x1000 0x00 0x1020e000 0x00 0x1000 0x00 0x18004000 0x00 0x1000 0x00 0x18002000 0x00 0x1000>;
		#clock-cells = <0x01>;
		linux,phandle = <0x25>;
		phandle = <0x25>;
	};

	topckgen@10000000 {
		compatible = "mediatek,topckgen\0syscon";
		reg = <0x00 0x10000000 0x00 0x1000>;
		#clock-cells = <0x01>;
		linux,phandle = <0x1e>;
		phandle = <0x1e>;
	};

	io_cfg_lt@10002000 {
		compatible = "mediatek,io_cfg_lt";
		reg = <0x00 0x10002000 0x00 0x200>;
	};

	syscfg_pctl_1@0x10002000 {
		compatible = "mediatek,mt6765-pctl-1-syscfg\0syscon";
		reg = <0x00 0x10002000 0x00 0x1000>;
		linux,phandle = <0x13>;
		phandle = <0x13>;
	};

	io_cfg_lm@10002200 {
		compatible = "mediatek,io_cfg_lm";
		reg = <0x00 0x10002200 0x00 0x200>;
	};

	syscfg_pctl_2@0x10002200 {
		compatible = "mediatek,mt6765-pctl-2-syscfg\0syscon";
		reg = <0x00 0x10002200 0x00 0x1000>;
		linux,phandle = <0x14>;
		phandle = <0x14>;
	};

	io_cfg_lb@10002400 {
		compatible = "mediatek,io_cfg_lb";
		reg = <0x00 0x10002400 0x00 0x200>;
	};

	syscfg_pctl_3@0x10002400 {
		compatible = "mediatek,mt6765-pctl-3-syscfg\0syscon";
		reg = <0x00 0x10002400 0x00 0x1000>;
		linux,phandle = <0x15>;
		phandle = <0x15>;
	};

	io_cfg_bl@10002600 {
		compatible = "mediatek,io_cfg_bl";
		reg = <0x00 0x10002600 0x00 0x200>;
	};

	syscfg_pctl_4@0x10002600 {
		compatible = "mediatek,mt6765-pctl-4-syscfg\0syscon";
		reg = <0x00 0x10002600 0x00 0x1000>;
		linux,phandle = <0x16>;
		phandle = <0x16>;
	};

	io_cfg_rr@10002800 {
		compatible = "mediatek,io_cfg_rr";
		reg = <0x00 0x10002800 0x00 0x200>;
	};

	syscfg_pctl_5@0x10002800 {
		compatible = "mediatek,mt6765-pctl-5-syscfg\0syscon";
		reg = <0x00 0x10002800 0x00 0x1000>;
		linux,phandle = <0x17>;
		phandle = <0x17>;
	};

	io_cfg_rb@10002a00 {
		compatible = "mediatek,io_cfg_rb";
		reg = <0x00 0x10002a00 0x00 0x200>;
	};

	syscfg_pctl_6@0x10002a00 {
		compatible = "mediatek,mt6765-pctl-6-syscfg\0syscon";
		reg = <0x00 0x10002a00 0x00 0x1000>;
		linux,phandle = <0x18>;
		phandle = <0x18>;
	};

	io_cfg_rt@10002c00 {
		compatible = "mediatek,io_cfg_rt";
		reg = <0x00 0x10002c00 0x00 0x200>;
	};

	syscfg_pctl_7@0x10002c00 {
		compatible = "mediatek,mt6765-pctl-7-syscfg\0syscon";
		reg = <0x00 0x10002c00 0x00 0x1000>;
		linux,phandle = <0x19>;
		phandle = <0x19>;
	};

	pericfg@10003000 {
		compatible = "mediatek,pericfg\0syscon";
		reg = <0x00 0x10003000 0x00 0x1000>;
		#clock-cells = <0x01>;
		linux,phandle = <0x4f>;
		phandle = <0x4f>;
	};

	efuse_dbg@10004000 {
		compatible = "mediatek,efuse_dbg";
		reg = <0x00 0x10004000 0x00 0x1000>;
	};

	gpio {
		compatible = "mediatek,gpio_usage_mapping";
		linux,phandle = <0x50>;
		phandle = <0x50>;
	};

	gpio@10005000 {
		compatible = "mediatek,gpio";
		reg = <0x00 0x10005000 0x00 0x1000>;
		linux,phandle = <0x51>;
		phandle = <0x51>;
	};

	syscfg_pctl_0@10005000 {
		compatible = "mediatek,mt6765-pctl-0-syscfg\0syscon";
		reg = <0x00 0x10005000 0x00 0x1000>;
		linux,phandle = <0x12>;
		phandle = <0x12>;
	};

	pinctrl@1000b000 {
		compatible = "mediatek,mt6765-pinctrl";
		reg = <0x00 0x1000b000 0x00 0x1000>;
		mediatek,pctl-regmap = <0x12 0x13 0x14 0x15 0x16 0x17 0x18 0x19>;
		pins-are-numbered;
		gpio-controller;
		#gpio-cells = <0x02>;
		interrupt-controller;
		#interrupt-cells = <0x04>;
		interrupts = <0x00 0xab 0x04>;
		linux,phandle = <0x3c>;
		phandle = <0x3c>;

		msdc0@default {
			linux,phandle = <0x32>;
			phandle = <0x32>;

			pins_cmd {
				drive-strength = [03];
			};

			pins_dat {
				drive-strength = [03];
			};

			pins_clk {
				drive-strength = [03];
			};

			pins_rst {
				drive-strength = [03];
			};

			pins_ds {
				drive-strength = [03];
			};
		};

		msdc0@hs400 {
			linux,phandle = <0x33>;
			phandle = <0x33>;

			pins_cmd {
				drive-strength = [03];
			};

			pins_dat {
				drive-strength = [04];
			};

			pins_clk {
				drive-strength = [04];
			};

			pins_rst {
				drive-strength = [03];
			};

			pins_ds {
				drive-strength = [04];
			};
		};

		msdc0@hs200 {
			linux,phandle = <0x34>;
			phandle = <0x34>;

			pins_cmd {
				drive-strength = [03];
			};

			pins_dat {
				drive-strength = [04];
			};

			pins_clk {
				drive-strength = [04];
			};

			pins_rst {
				drive-strength = [03];
			};

			pins_ds {
				drive-strength = [04];
			};
		};

		msdc0@register_default {
			cmd_edge = [00];
			rdata_edge = [00];
			wdata_edge = [00];
			linux,phandle = <0x35>;
			phandle = <0x35>;
		};

		msdc1@default {
			linux,phandle = <0x37>;
			phandle = <0x37>;

			pins_cmd {
				drive-strength = [03];
			};

			pins_dat {
				drive-strength = [03];
			};

			pins_clk {
				drive-strength = [03];
			};
		};

		msdc1@sdr104 {
			linux,phandle = <0x38>;
			phandle = <0x38>;

			pins_cmd {
				drive-strength = [03];
			};

			pins_dat {
				drive-strength = [03];
			};

			pins_clk {
				drive-strength = [03];
			};
		};

		msdc1@sdr50 {
			linux,phandle = <0x39>;
			phandle = <0x39>;

			pins_cmd {
				drive-strength = [03];
			};

			pins_dat {
				drive-strength = [03];
			};

			pins_clk {
				drive-strength = [03];
			};
		};

		msdc1@ddr50 {
			linux,phandle = <0x3a>;
			phandle = <0x3a>;

			pins_cmd {
				drive-strength = [03];
			};

			pins_dat {
				drive-strength = [03];
			};

			pins_clk {
				drive-strength = [03];
			};
		};

		msdc1@register_default {
			cmd_edge = [00];
			rdata_edge = [00];
			wdata_edge = [00];
			linux,phandle = <0x3b>;
			phandle = <0x3b>;
		};

		msdc3@default {
			linux,phandle = <0x52>;
			phandle = <0x52>;

			pins_cmd {
				drive-strength = [04];
			};

			pins_dat {
				drive-strength = [04];
			};

			pins_clk {
				drive-strength = [04];
			};
		};

		msdc3@register_default {
			cmd_edge = [01];
			rdata_edge = [01];
			wdata_edge = [01];
			linux,phandle = <0x53>;
			phandle = <0x53>;
		};
	};

	sleep@10006000 {
		compatible = "mediatek,sleep";
		reg = <0x00 0x10006000 0x00 0x1000>;
		interrupts = <0x00 0xb5 0x08>;
		wakeup-source = <0x1a 0x00 0x04 0x1b 0x01 0x20 0x1c 0x03 0x2000000>;
	};

	toprgu@10007000 {
		compatible = "mediatek,mt6765-toprgu";
		reg = <0x00 0x10007000 0x00 0x1000>;
		interrupts = <0x00 0x8b 0x00>;
	};

	chipid@08000000 {
		compatible = "mediatek,chipid";
		reg = <0x00 0x8000000 0x00 0x04 0x00 0x8000004 0x00 0x04 0x00 0x8000008 0x00 0x04 0x00 0x800000c 0x00 0x04>;
	};

	mobicore {
		compatible = "trustonic,mobicore";
		interrupts = <0x00 0x10f 0x01>;
	};

	timer {
		compatible = "arm,armv8-timer";
		interrupt-parent = <0x11>;
		interrupts = <0x01 0x0d 0x08 0x01 0x0e 0x08 0x01 0x0b 0x08 0x01 0x0a 0x08>;
		clock-frequency = <0xc65d40>;
	};

	clocks {

		clk26m {
			compatible = "fixed-clock";
			#clock-cells = <0x00>;
			clock-frequency = <0x18cba80>;
			linux,phandle = <0x1f>;
			phandle = <0x1f>;
		};

		clk32k {
			compatible = "fixed-clock";
			#clock-cells = <0x00>;
			clock-frequency = <0x7d00>;
			linux,phandle = <0x1d>;
			phandle = <0x1d>;
		};
	};

	apxgpt@10008000 {
		compatible = "mediatek,apxgpt";
		reg = <0x00 0x10008000 0x00 0x1000>;
		interrupts = <0x00 0xaa 0x08>;
		clocks = <0x1d>;
	};

	hacc@1000a000 {
		compatible = "mediatek,hacc";
		reg = <0x00 0x1000a000 0x00 0x1000>;
		interrupts = <0x00 0xbd 0x08>;
	};

	apmixed@1000c000 {
		compatible = "mediatek,apmixed\0syscon";
		reg = <0x00 0x1000c000 0x00 0x1000>;
		#clock-cells = <0x01>;
		linux,phandle = <0x41>;
		phandle = <0x41>;
	};

	fhctl@1000ce00 {
		compatible = "mediatek,fhctl";
		reg = <0x00 0x1000ce00 0x00 0x200>;
	};

	pwrap@1000d000 {
		compatible = "mediatek,pwrap";
		reg = <0x00 0x1000d000 0x00 0x1000>;
		interrupts = <0x00 0xb3 0x04>;
	};

	mt-pmic {
		compatible = "mediatek,mt_pmic";
		interrupt-controller;
		linux,phandle = <0x54>;
		phandle = <0x54>;

		mt635x-auxadc {
			compatible = "mediatek,mt635x-auxadc";
			#io-channel-cells = <0x01>;
			linux,phandle = <0x55>;
			phandle = <0x55>;

			batadc {
				channel = <0x00>;
				resistance-ratio = <0x03 0x01>;
				avg-num = <0x80>;
			};

			isense {
				channel = <0x01>;
				resistance-ratio = <0x03 0x01>;
				avg-num = <0x80>;
			};

			vcdt {
				channel = <0x02>;
			};

			bat_temp {
				channel = <0x03>;
				resistance-ratio = <0x01 0x01>;
			};

			chip_temp {
				channel = <0x05>;
			};

			vcore_temp {
				channel = <0x06>;
			};

			vproc_temp {
				channel = <0x07>;
			};

			accdet {
				channel = <0x09>;
			};

			tsx_temp {
				channel = <0x0b>;
				avg-num = <0x80>;
			};

			hpofs_cal {
				channel = <0x0c>;
				avg-num = <0x100>;
			};

			dcxo_temp {
				channel = <0x0d>;
				avg-num = <0x10>;
			};

			vbif {
				channel = <0x0e>;
				resistance-ratio = <0x01 0x01>;
			};
		};

		buck_regulators {

			buck_vs1 {
				regulator-name = "vs1";
				regulator-min-microvolt = <0x124f80>;
				regulator-max-microvolt = <0x2191c0>;
				regulator-ramp-delay = <0x30d4>;
				regulator-enable-ramp-delay = <0xdc>;
				linux,phandle = <0x56>;
				phandle = <0x56>;
			};

			buck_vmodem {
				regulator-name = "vmodem";
				regulator-min-microvolt = <0x7a120>;
				regulator-max-microvolt = <0x123716>;
				regulator-ramp-delay = <0x186a>;
				regulator-enable-ramp-delay = <0xdc>;
				linux,phandle = <0x57>;
				phandle = <0x57>;
			};

			buck_vcore {
				regulator-name = "vcore";
				regulator-min-microvolt = <0x7ea5e>;
				regulator-max-microvolt = <0x1406f4>;
				regulator-ramp-delay = <0x186a>;
				regulator-enable-ramp-delay = <0xdc>;
				linux,phandle = <0x58>;
				phandle = <0x58>;
			};

			buck_vproc {
				regulator-name = "vproc";
				regulator-min-microvolt = <0x7ea5e>;
				regulator-max-microvolt = <0x1406f4>;
				regulator-ramp-delay = <0x186a>;
				regulator-enable-ramp-delay = <0xdc>;
				linux,phandle = <0x59>;
				phandle = <0x59>;
			};

			buck_vpa {
				regulator-name = "vpa";
				regulator-min-microvolt = <0x7a120>;
				regulator-max-microvolt = <0x37b1d0>;
				regulator-ramp-delay = <0xc350>;
				regulator-enable-ramp-delay = <0xdc>;
				linux,phandle = <0x5a>;
				phandle = <0x5a>;
			};
		};

		ldo_regulators {

			ldo_vfe28 {
				compatible = "regulator-fixed";
				regulator-name = "vfe28";
				regulator-min-microvolt = <0x2ab980>;
				regulator-max-microvolt = <0x2ab980>;
				regulator-enable-ramp-delay = <0x108>;
				linux,phandle = <0x5b>;
				phandle = <0x5b>;
			};

			ldo_vxo22 {
				regulator-name = "vxo22";
				regulator-min-microvolt = <0x2191c0>;
				regulator-max-microvolt = <0x249f00>;
				regulator-enable-ramp-delay = <0x6e>;
				linux,phandle = <0x5c>;
				phandle = <0x5c>;
			};

			ldo_vrf18 {
				compatible = "regulator-fixed";
				regulator-name = "vrf18";
				regulator-min-microvolt = <0x1b7740>;
				regulator-max-microvolt = <0x1b7740>;
				regulator-enable-ramp-delay = <0x6e>;
				linux,phandle = <0x5d>;
				phandle = <0x5d>;
			};

			ldo_vrf12 {
				compatible = "regulator-fixed";
				regulator-name = "vrf12";
				regulator-min-microvolt = <0x124f80>;
				regulator-max-microvolt = <0x124f80>;
				regulator-enable-ramp-delay = <0x6e>;
				linux,phandle = <0x5e>;
				phandle = <0x5e>;
			};

			ldo_vefuse {
				regulator-name = "vefuse";
				regulator-min-microvolt = <0x124f80>;
				regulator-max-microvolt = <0x325aa0>;
				regulator-enable-ramp-delay = <0x108>;
				linux,phandle = <0x5f>;
				phandle = <0x5f>;
			};

			ldo_vcn33_bt {
				regulator-name = "vcn33_bt";
				regulator-min-microvolt = <0x325aa0>;
				regulator-max-microvolt = <0x3567e0>;
				regulator-enable-ramp-delay = <0x108>;
				linux,phandle = <0x60>;
				phandle = <0x60>;
			};

			ldo_vcn33_wifi {
				regulator-name = "vcn33_wifi";
				regulator-min-microvolt = <0x325aa0>;
				regulator-max-microvolt = <0x3567e0>;
				regulator-enable-ramp-delay = <0x108>;
				linux,phandle = <0x61>;
				phandle = <0x61>;
			};

			ldo_vcn28 {
				compatible = "regulator-fixed";
				regulator-name = "vcn28";
				regulator-min-microvolt = <0x2ab980>;
				regulator-max-microvolt = <0x2ab980>;
				regulator-enable-ramp-delay = <0x108>;
				linux,phandle = <0x62>;
				phandle = <0x62>;
			};

			ldo_vcn18 {
				compatible = "regulator-fixed";
				regulator-name = "vcn18";
				regulator-min-microvolt = <0x1b7740>;
				regulator-max-microvolt = <0x1b7740>;
				regulator-enable-ramp-delay = <0x108>;
				linux,phandle = <0x63>;
				phandle = <0x63>;
			};

			ldo_vcama {
				regulator-name = "vcama";
				regulator-min-microvolt = <0x2625a0>;
				regulator-max-microvolt = <0x2ab980>;
				regulator-enable-ramp-delay = <0x108>;
				linux,phandle = <0x64>;
				phandle = <0x64>;
			};

			ldo_vcamd {
				regulator-name = "vcamd";
				regulator-min-microvolt = <0xf4240>;
				regulator-max-microvolt = <0x1b7740>;
				regulator-enable-ramp-delay = <0x108>;
				linux,phandle = <0x65>;
				phandle = <0x65>;
			};

			ldo_vcamio {
				compatible = "regulator-fixed";
				regulator-name = "vcamio";
				regulator-min-microvolt = <0x1b7740>;
				regulator-max-microvolt = <0x1b7740>;
				regulator-enable-ramp-delay = <0x108>;
				linux,phandle = <0x66>;
				phandle = <0x66>;
			};

			ldo_vldo28 {
				regulator-name = "vldo28";
				regulator-min-microvolt = <0x2ab980>;
				regulator-max-microvolt = <0x2dc6c0>;
				regulator-enable-ramp-delay = <0x108>;
				linux,phandle = <0x67>;
				phandle = <0x67>;
			};

			ldo_vsram_others {
				regulator-name = "vsram_others";
				regulator-min-microvolt = <0x7ea5e>;
				regulator-max-microvolt = <0x1406f4>;
				regulator-ramp-delay = <0x186a>;
				regulator-enable-ramp-delay = <0x6e>;
				linux,phandle = <0x68>;
				phandle = <0x68>;
			};

			ldo_vsram_proc {
				regulator-name = "vsram_proc";
				regulator-min-microvolt = <0x7ea5e>;
				regulator-max-microvolt = <0x1406f4>;
				regulator-ramp-delay = <0x186a>;
				regulator-enable-ramp-delay = <0x6e>;
				linux,phandle = <0x69>;
				phandle = <0x69>;
			};

			ldo_vaux18 {
				compatible = "regulator-fixed";
				regulator-name = "vaux18";
				regulator-min-microvolt = <0x1b7740>;
				regulator-max-microvolt = <0x1b7740>;
				regulator-enable-ramp-delay = <0x108>;
				linux,phandle = <0x6a>;
				phandle = <0x6a>;
			};

			ldo_vaud28 {
				compatible = "regulator-fixed";
				regulator-name = "vaud28";
				regulator-min-microvolt = <0x2ab980>;
				regulator-max-microvolt = <0x2ab980>;
				regulator-enable-ramp-delay = <0x108>;
				linux,phandle = <0x6b>;
				phandle = <0x6b>;
			};

			ldo_vio28 {
				compatible = "regulator-fixed";
				regulator-name = "vio28";
				regulator-min-microvolt = <0x2ab980>;
				regulator-max-microvolt = <0x2ab980>;
				regulator-enable-ramp-delay = <0x108>;
				linux,phandle = <0x6c>;
				phandle = <0x6c>;
			};

			ldo_vio18 {
				compatible = "regulator-fixed";
				regulator-name = "vio18";
				regulator-min-microvolt = <0x1b7740>;
				regulator-max-microvolt = <0x1b7740>;
				regulator-enable-ramp-delay = <0x108>;
				linux,phandle = <0x6d>;
				phandle = <0x6d>;
			};

			ldo_vdram {
				regulator-name = "vdram";
				regulator-min-microvolt = <0x10c8e0>;
				regulator-max-microvolt = <0x124f80>;
				regulator-enable-ramp-delay = <0xce4>;
				linux,phandle = <0x6e>;
				phandle = <0x6e>;
			};

			ldo_vmc {
				regulator-name = "vmc";
				regulator-min-microvolt = <0x1b7740>;
				regulator-max-microvolt = <0x325aa0>;
				regulator-enable-ramp-delay = <0x2c>;
				linux,phandle = <0x3e>;
				phandle = <0x3e>;
			};

			ldo_vmch {
				regulator-name = "vmch";
				regulator-min-microvolt = <0x2c4020>;
				regulator-max-microvolt = <0x325aa0>;
				regulator-enable-ramp-delay = <0x2c>;
				linux,phandle = <0x3d>;
				phandle = <0x3d>;
			};

			ldo_vemc {
				regulator-name = "vemc";
				regulator-min-microvolt = <0x2c4020>;
				regulator-max-microvolt = <0x325aa0>;
				regulator-enable-ramp-delay = <0x2c>;
				linux,phandle = <0x36>;
				phandle = <0x36>;
			};

			ldo_vsim1 {
				regulator-name = "vsim1";
				regulator-min-microvolt = <0x19f0a0>;
				regulator-max-microvolt = <0x2f4d60>;
				regulator-enable-ramp-delay = <0x108>;
				linux,phandle = <0x6f>;
				phandle = <0x6f>;
			};

			ldo_vsim2 {
				regulator-name = "vsim2";
				regulator-min-microvolt = <0x19f0a0>;
				regulator-max-microvolt = <0x2f4d60>;
				regulator-enable-ramp-delay = <0x108>;
				linux,phandle = <0x70>;
				phandle = <0x70>;
			};

			ldo_vibr {
				regulator-name = "vibr";
				regulator-min-microvolt = <0x124f80>;
				regulator-max-microvolt = <0x325aa0>;
				regulator-enable-ramp-delay = <0x2c>;
				linux,phandle = <0x71>;
				phandle = <0x71>;
			};

			ldo_vusb33 {
				regulator-name = "vusb33";
				regulator-min-microvolt = <0x2dc6c0>;
				regulator-max-microvolt = <0x2f4d60>;
				regulator-enable-ramp-delay = <0x108>;
				linux,phandle = <0x72>;
				phandle = <0x72>;
			};
		};
	};

	scp@10500000 {
		compatible = "mediatek,scp";
		status = "okay";
		reg = <0x00 0x10500000 0x00 0x40000 0x00 0x105c0000 0x00 0x3000 0x00 0x105c4000 0x00 0x1000 0x00 0x105d4000 0x00 0x6000>;
		interrupts = <0x00 0xc0 0x04>;
		core_1 = "enable";
		scp_sramSize = <0x40000>;
	};

	scp_dvfs {
		compatible = "mediatek,scp_dvfs";
		clocks = <0x1e 0x63 0x1f 0x1e 0x0e 0x1e 0x1a 0x1e 0x02 0x1e 0x17 0x1e 0x06 0x1e 0x19>;
		clock-names = "clk_mux\0clk_pll_0\0clk_pll_1\0clk_pll_2\0clk_pll_3\0clk_pll_4\0clk_pll_5\0clk_pll_6";
	};

	sleep_reg_md@1000f000 {
		compatible = "mediatek,sleep_reg_md";
		reg = <0x00 0x1000f000 0x00 0x1000>;
	};

	kp@10010000 {
		compatible = "mediatek,kp";
		reg = <0x00 0x10010000 0x00 0x1000>;
		interrupts = <0x00 0xb4 0x02>;
		linux,phandle = <0x1a>;
		phandle = <0x1a>;
	};

	otg_iddig {
		compatible = "mediatek,usb_iddig_bi_eint";
		linux,phandle = <0x73>;
		phandle = <0x73>;
	};

	mrdump_ext_rst {
		compatible = "mediatek, mrdump_ext_rst-eint";
		force_mode = "EINT";
		mode = "IRQ";
		status = "okay";
		linux,phandle = <0x74>;
		phandle = <0x74>;
	};

	touch {
		compatible = "mediatek,touch";
		linux,phandle = <0x75>;
		phandle = <0x75>;
	};

	stepmotor {
		compatible = "mediatek,stepmotor";
		linux,phandle = <0x76>;
		phandle = <0x76>;
	};

	accdet {
		compatible = "mediatek,pmic-accdet";
		linux,phandle = <0x77>;
		phandle = <0x77>;
	};

	fingerprint {
		compatible = "mediatek,goodix-fp";
		linux,phandle = <0x78>;
		phandle = <0x78>;
	};

	mt6357_gauge {
		compatible = "mediatek,mt6357_gauge";
		gauge_name = "gauge";
		alias_name = "mt6357";
	};

	gauge_timer {
		compatible = "mediatek,gauge_timer_service";
	};

	battery {
		compatible = "mediatek,bat_gm30";
		DIFFERENCE_FULLOCV_ITH = <0xc8>;
		SHUTDOWN_1_TIME = <0x1e>;
		KEEP_100_PERCENT = <0x01>;
		R_FG_VALUE = <0x0a>;
		EMBEDDED_SEL = <0x01>;
		PMIC_SHUTDOWN_CURRENT = <0x14>;
		FG_METER_RESISTANCE = <0x4b>;
		CAR_TUNE_VALUE = <0x64>;
		PMIC_MIN_VOL = <0x82dc>;
		POWERON_SYSTEM_IBOOT = <0x1f4>;
		SHUTDOWN_GAUGE0_VOLTAGE = <0x84d0>;
		TEMPERATURE_T0 = <0x32>;
		TEMPERATURE_T1 = <0x19>;
		TEMPERATURE_T2 = <0x0a>;
		TEMPERATURE_T3 = <0x00>;
		TEMPERATURE_T4 = <0xfffffff6>;
		g_FG_PSEUDO100_T0 = <0x64>;
		g_FG_PSEUDO100_T1 = <0x64>;
		g_FG_PSEUDO100_T2 = <0x64>;
		g_FG_PSEUDO100_T3 = <0x64>;
		g_FG_PSEUDO100_T4 = <0x64>;
		Q_MAX_SYS_VOLTAGE_BAT0 = <0xd16>;
		Q_MAX_SYS_VOLTAGE_BAT1 = <0xd16>;
		Q_MAX_SYS_VOLTAGE_BAT2 = <0xd16>;
		Q_MAX_SYS_VOLTAGE_BAT3 = <0xd16>;
		battery3_profile_t0_num = <0x64>;
		battery3_profile_t0 = <0x00 0xab68 0x4ba 0x197 0xaac4 0x4ba 0x32f 0xaa49 0x4af 0x4c6 0xa9cd 0x4a5 0x65d 0xa952 0x49d 0x7f4 0xa8df 0x4a6 0x98c 0xa864 0x4a6 0xb23 0xa7e8 0x4a4 0xcba 0xa76f 0x49c 0xe51 0xa6fa 0x49c 0xfe9 0xa682 0x49f 0x1180 0xa60d 0x4a6 0x1317 0xa595 0x4a2 0x14af 0xa520 0x4a0 0x1646 0xa4a8 0x4a6 0x17dd 0xa432 0x4a6 0x1974 0xa3bb 0x4a6 0x1b0c 0xa34a 0x4a6 0x1ca3 0xa2d8 0x4ac 0x1e3a 0xa267 0x4b0 0x1fd1 0xa1f6 0x4b0 0x2169 0xa184 0x4b7 0x2300 0xa113 0x4b3 0x2497 0xa0a9 0x4b7 0x262f 0xa03a 0x4ba 0x27c6 0x9fd0 0x4c2 0x295d 0x9f69 0x4c4 0x2af4 0x9f02 0x4cc 0x2c8c 0x9e9b 0x4d7 0x2e23 0x9e34 0x4d8 0x2fba 0x9dcd 0x4e1 0x3151 0x9d6f 0x4e2 0x32e9 0x9d09 0x4e2 0x3480 0x9cac 0x4ec 0x3617 0x9c4f 0x4f7 0x37af 0x9bfc 0x50a 0x3946 0x9ba1 0x50c 0x3add 0x9b4d 0x51e 0x3c74 0x9aa2 0x53c 0x3e0c 0x9a4d 0x53e 0x3fa3 0x99ee 0x546 0x413a 0x9984 0x543 0x42d1 0x990f 0x52a 0x4469 0x9894 0x4ef 0x4600 0x981f 0x4c7 0x4797 0x97c0 0x4b6 0x492f 0x976e 0x4a7 0x4ac6 0x9724 0x49c 0x4c5d 0x96e7 0x49c 0x4df4 0x96a9 0x497 0x4f8c 0x966b 0x492 0x5123 0x9633 0x498 0x52ba 0x95ff 0x49c 0x5451 0x95cc 0x49c 0x55e9 0x959f 0x4a3 0x5780 0x956f 0x4a6 0x5917 0x9542 0x49f 0x5aaf 0x9511 0x4a4 0x5c46 0x94ee 0x4ae 0x5ddd 0x94be 0x4b0 0x5f74 0x949c 0x4b0 0x610c 0x947d 0x4c2 0x62a3 0x9455 0x4c4 0x643a 0x9435 0x4ce 0x65d1 0x9416 0x4d8 0x6769 0x93f7 0x4d8 0x6900 0x93d8 0x4ec 0x6a97 0x93ba 0x4ed 0x6c2f 0x9399 0x4f4 0x6dc6 0x936d 0x4df 0x6f5d 0x932e 0x4c9 0x70f4 0x92e6 0x4ac 0x728c 0x92a2 0x49e 0x7423 0x9271 0x4a9 0x75ba 0x9248 0x4ad 0x7751 0x921f 0x4a9 0x78e9 0x91f2 0x4ac 0x7a80 0x91c6 0x4a6 0x7c17 0x91a3 0x4aa 0x7daf 0x917e 0x4b5 0x7f46 0x9156 0x4ba 0x80dd 0x9127 0x4c4 0x8274 0x90ee 0x4be 0x840c 0x90ab 0x4b6 0x85a3 0x9074 0x4c0 0x873a 0x9033 0x4c4 0x88d1 0x8feb 0x4a9 0x8a69 0x8fb8 0x495 0x8c00 0x8fa5 0x4a8 0x8d97 0x8faa 0x4de 0x8f2f 0x8f8c 0x4dc 0x90c6 0x8f73 0x512 0x925d 0x8f5f 0x55a 0x93f4 0x8ef1 0x549 0x958c 0x8db4 0x4ea 0x9723 0x8be4 0x4ff 0x98ba 0x8980 0x51d 0x9a51 0x8124 0x5f0 0x9be9 0x8124 0x5f0 0x9d80 0x8124 0x5f0>;
		battery3_profile_t1_num = <0x64>;
		battery3_profile_t1 = <0x00 0xabb8 0x672 0x197 0xaaf8 0x672 0x32f 0xaa61 0x672 0x4c6 0xa9e8 0x672 0x65d 0xa96f 0x667 0x7f4 0xa8f6 0x654 0x98c 0xa886 0x653 0xb23 0xa80d 0x64a 0xcba 0xa794 0x64a 0xe51 0xa71c 0x648 0xfe9 0xa6ab 0x637 0x1180 0xa633 0x640 0x1317 0xa5c3 0x63f 0x14af 0xa54b 0x637 0x1646 0xa4dc 0x63f 0x17dd 0xa46b 0x636 0x1974 0xa385 0x636 0x1b0c 0xa316 0x638 0x1ca3 0xa2a9 0x642 0x1e3a 0xa240 0x648 0x1fd1 0xa1cb 0x644 0x2169 0xa164 0x654 0x2300 0xa0f7 0x656 0x2497 0xa08f 0x65e 0x262f 0xa020 0x65e 0x27c6 0x9fb3 0x661 0x295d 0x9f4e 0x66b 0x2af4 0x9eef 0x678 0x2c8c 0x9ea4 0x698 0x2e23 0x9e64 0x6c8 0x2fba 0x9e0e 0x6d0 0x3151 0x9d84 0x6b5 0x32e9 0x9cdf 0x69a 0x3480 0x9c4f 0x69a 0x3617 0x9bd6 0x6a5 0x37af 0x9b7c 0x6bc 0x3946 0x9b3d 0x6cd 0x3add 0x9b0a 0x6e8 0x3c74 0x9ad0 0x6f4 0x3e0c 0x9a85 0x6f0 0x3fa3 0x9a30 0x6e6 0x413a 0x99d5 0x6e0 0x42d1 0x9975 0x6d3 0x4469 0x990c 0x6b0 0x4600 0x989d 0x687 0x4797 0x9832 0x651 0x492f 0x97cd 0x61d 0x4ac6 0x9772 0x604 0x4c5d 0x9726 0x5f5 0x4df4 0x969f 0x5e6 0x4f8c 0x9662 0x5dc 0x5123 0x962b 0x5dc 0x52ba 0x95f3 0x5d6 0x5451 0x95bc 0x5cc 0x55e9 0x958f 0x5d3 0x5780 0x9561 0x5e2 0x5917 0x9534 0x5e0 0x5aaf 0x950c 0x5dc 0x5c46 0x94e3 0x5dc 0x5ddd 0x94bb 0x5e2 0x5f74 0x9486 0x567 0x610c 0x9470 0x518 0x62a3 0x9456 0x584 0x643a 0x942d 0x5d9 0x65d1 0x940c 0x5fa 0x6769 0x93ed 0x60b 0x6900 0x93cf 0x60e 0x6a97 0x93b1 0x60e 0x6c2f 0x9392 0x60e 0x6dc6 0x9374 0x615 0x6f5d 0x935d 0x618 0x70f4 0x9341 0x618 0x728c 0x931b 0x610 0x7423 0x92fb 0x5ff 0x75ba 0x92d5 0x5ea 0x7751 0x92b4 0x5e6 0x78e9 0x9296 0x5e6 0x7a80 0x9278 0x5e6 0x7c17 0x9249 0x5de 0x7daf 0x9227 0x5e4 0x7f46 0x9200 0x5e6 0x80dd 0x91c2 0x5fa 0x8274 0x9193 0x5fa 0x840c 0x9157 0x603 0x85a3 0x911b 0x60d 0x873a 0x90de 0x60e 0x88d1 0x90aa 0x617 0x8a69 0x905c 0x621 0x8c00 0x900b 0x60f 0x8d97 0x8fea 0x617 0x8f2f 0x8fde 0x635 0x90c6 0x8fd4 0x653 0x925d 0x8fc0 0x671 0x93f4 0x8fac 0x6ad 0x958c 0x8f70 0x6e0 0x9723 0x8eeb 0x708 0x98ba 0x8d87 0x6d7 0x9a51 0x8b7f 0x70b 0x9be9 0x88d9 0x767 0x9d80 0x8548 0x7da>;
		battery3_profile_t2_num = <0x64>;
		battery3_profile_t2 = <0x00 0xab68 0xb4a 0x197 0xaa9d 0xb48 0x32f 0xa9fc 0xad1 0x4c6 0xa977 0xabd 0x65d 0xa8f3 0xaa8 0x7f4 0xa870 0xa8b 0x98c 0xa7f6 0xa7e 0xb23 0xa77d 0xa5a 0xcba 0xa70d 0xa57 0xe51 0xa69c 0xa43 0xfe9 0xa623 0xa30 0x1180 0xa5b4 0xa24 0x1317 0xa544 0xa12 0x14af 0xa4d4 0xa06 0x1646 0xa464 0x9f4 0x17dd 0xa3f4 0x9ef 0x1974 0xa384 0x9f1 0x1b0c 0xa317 0x9e5 0x1ca3 0xa2af 0x9e9 0x1e3a 0xa242 0x9e5 0x1fd1 0xa16b 0x9ef 0x2169 0xa0fe 0x9e9 0x2300 0xa095 0x9f6 0x2497 0xa029 0x9f6 0x262f 0x9fc3 0x9f2 0x27c6 0x9f62 0x9f0 0x295d 0x9f0f 0xa03 0x2af4 0x9ec8 0xa34 0x2c8c 0x9e77 0xa72 0x2e23 0x9e08 0xa82 0x2fba 0x9d70 0xa54 0x3151 0x9cbe 0xa13 0x32e9 0x9c17 0x9e6 0x3480 0x9b89 0x9c7 0x3617 0x9b17 0x9b4 0x37af 0x9ab7 0x9a4 0x3946 0x9a67 0x99c 0x3add 0x9a20 0x996 0x3c74 0x99df 0x992 0x3e0c 0x9995 0x97e 0x3fa3 0x9944 0x959 0x413a 0x98ec 0x937 0x42d1 0x9890 0x912 0x4469 0x983c 0x8e9 0x4600 0x97ea 0x8cf 0x4797 0x9799 0x8bb 0x492f 0x9748 0x8a6 0x4ac6 0x9706 0x8a2 0x4c5d 0x96c1 0x89a 0x4df4 0x9682 0x890 0x4f8c 0x9645 0x87d 0x5123 0x9611 0x88b 0x52ba 0x95d5 0x87c 0x5451 0x95a1 0x883 0x55e9 0x956e 0x88d 0x5780 0x9545 0x897 0x5917 0x9513 0x898 0x5aaf 0x94e9 0x898 0x5c46 0x94c1 0x8a2 0x5ddd 0x9498 0x8a2 0x5f74 0x9452 0x8c0 0x610c 0x9433 0x8c0 0x62a3 0x940b 0x8c0 0x643a 0x93ec 0x8ca 0x65d1 0x93ce 0x8cb 0x6769 0x93af 0x8d4 0x6900 0x9392 0x8d4 0x6a97 0x937d 0x8d5 0x6c2f 0x9369 0x8df 0x6dc6 0x9355 0x8e8 0x6f5d 0x9340 0x8ec 0x70f4 0x932e 0x900 0x728c 0x931f 0x910 0x7423 0x9303 0x917 0x75ba 0x92ec 0x931 0x7751 0x92d1 0x93d 0x78e9 0x92b9 0x94f 0x7a80 0x9298 0x95f 0x7c17 0x9272 0x97e 0x7daf 0x9251 0x99c 0x7f46 0x9228 0x9c5 0x80dd 0x91ff 0x9fb 0x8274 0x91cf 0xa23 0x840c 0x9192 0xa50 0x85a3 0x9155 0xa83 0x873a 0x9118 0xabf 0x88d1 0x90d2 0xb06 0x8a69 0x9085 0xb52 0x8c00 0x9043 0xb9e 0x8d97 0x9015 0xbff 0x8f2f 0x8ff6 0xc79 0x90c6 0x8fdd 0xd0e 0x925d 0x8fc3 0xdcb 0x93f4 0x8f94 0xea8 0x958c 0x8f39 0xfa3 0x9723 0x8e74 0x10ac 0x98ba 0x8d0c 0x11a8 0x9a51 0x8afb 0x130f 0x9be9 0x8816 0x152a 0x9d80 0x8200 0x19dc>;
		battery3_profile_t3_num = <0x64>;
		battery3_profile_t3 = <0x00 0xabd6 0x11c6 0x197 0xaaf6 0x11cf 0x32f 0xaa3e 0x1358 0x4c6 0xa992 0x1389 0x65d 0xa8f8 0x1399 0x7f4 0xa861 0x137b 0x98c 0xa7dc 0x135c 0xb23 0xa757 0x133c 0xcba 0xa6d6 0x1318 0xe51 0xa663 0x1308 0xfe9 0xa5e8 0x12dc 0x1180 0xa56e 0x12b3 0x1317 0xa4f6 0x129e 0x14af 0xa485 0x1271 0x1646 0xa415 0x1252 0x17dd 0xa3a4 0x1237 0x1974 0xa333 0x121f 0x1b0c 0xa2c7 0x1204 0x1ca3 0xa25c 0x11f0 0x1e3a 0xa1ec 0x11db 0x1fd1 0xa17b 0x11cb 0x2169 0xa10b 0x11b3 0x2300 0xa09f 0x118a 0x2497 0xa03e 0x1176 0x262f 0x9f98 0x11b0 0x27c6 0x9f3a 0x11dd 0x295d 0x9ece 0x11e8 0x2af4 0x9e4b 0x11cb 0x2c8c 0x9daf 0x117b 0x2e23 0x9cfe 0x1101 0x2fba 0x9c53 0x108a 0x3151 0x9bbe 0x102f 0x32e9 0x9b3e 0xff3 0x3480 0x9aca 0xfcf 0x3617 0x9a69 0xfb8 0x37af 0x9a1e 0xfbc 0x3946 0x99ce 0xfbe 0x3add 0x998d 0xfad 0x3c74 0x993e 0xfaa 0x3e0c 0x98f5 0xf98 0x3fa3 0x98ad 0xf84 0x413a 0x985c 0xf6f 0x42d1 0x9814 0xf5b 0x4469 0x97cd 0xf46 0x4600 0x9785 0xf50 0x4797 0x9747 0xf3d 0x492f 0x9700 0xf4f 0x4ac6 0x96c3 0xf44 0x4c5d 0x9687 0xf33 0x4df4 0x9652 0xf3c 0x4f8c 0x9616 0xf3f 0x5123 0x95e3 0xf52 0x52ba 0x95b0 0xf5a 0x5451 0x957d 0xf5e 0x55e9 0x954c 0xf6e 0x5780 0x9521 0xf71 0x5917 0x94f0 0xf81 0x5aaf 0x94c7 0xf99 0x5c46 0x94a2 0xfa3 0x5ddd 0x9480 0xfb5 0x5f74 0x945b 0xfc8 0x610c 0x943c 0xfd4 0x62a3 0x9421 0xff3 0x643a 0x940d 0x1012 0x65d1 0x93f9 0x1030 0x6769 0x93e4 0x1059 0x6900 0x93d0 0x1082 0x6a97 0x93bb 0x10b6 0x6c2f 0x93ac 0x10f2 0x6dc6 0x939c 0x112b 0x6f5d 0x9388 0x1169 0x70f4 0x935f 0x1210 0x728c 0x9344 0x1269 0x7423 0x932c 0x12c1 0x75ba 0x9311 0x1325 0x7751 0x92f2 0x13a1 0x78e9 0x92d3 0x1417 0x7a80 0x92ad 0x1497 0x7c17 0x9284 0x1524 0x7daf 0x925b 0x15c3 0x7f46 0x922a 0x1667 0x80dd 0x91f7 0x1702 0x8274 0x91c4 0x17b6 0x840c 0x9187 0x188a 0x85a3 0x9141 0x1960 0x873a 0x9102 0x1a41 0x88d1 0x90c5 0x1b49 0x8a69 0x9092 0x1c49 0x8c00 0x905f 0x1d88 0x8d97 0x9035 0x1ef0 0x8f2f 0x9002 0x208c 0x90c6 0x8fcd 0x2255 0x925d 0x8f7e 0x2466 0x93f4 0x8eee 0x26af 0x958c 0x8e03 0x290d 0x9723 0x8c9b 0x2bba 0x98ba 0x8aa8 0x2ea6 0x9a51 0x87e9 0x321d 0x9be9 0x8548 0x3548 0x9d80 0x8548 0x3548>;
		battery3_profile_t4_num = <0x64>;
		battery3_profile_t4 = <0x00 0xab36 0x19c8 0x197 0xaa3a 0x19c2 0x32f 0xa965 0x17b0 0x4c6 0xa87e 0x23e3 0x65d 0xa7c0 0x2348 0x7f4 0xa727 0x1d49 0x98c 0xa67d 0x22f1 0xb23 0xa5e6 0x229a 0xcba 0xa559 0x2211 0xe51 0xa4d4 0x1da2 0xfe9 0xa43f 0x21c6 0x1180 0xa3bd 0x219a 0x1317 0xa342 0x2152 0x14af 0xa2c0 0x2104 0x1646 0xa247 0x20cd 0x17dd 0xa1ce 0x20b6 0x1974 0xa0e0 0x2021 0x1b0c 0xa07b 0x1feb 0x1ca3 0xa018 0x1f82 0x1e3a 0x9fbd 0x202a 0x1fd1 0x9f5e 0x2048 0x2169 0x9eea 0x205c 0x2300 0x9e63 0x1fc9 0x2497 0x9dc9 0x1f08 0x262f 0x9d22 0x1d68 0x27c6 0x9c74 0x1e19 0x295d 0x9bdf 0x1da8 0x2af4 0x9b57 0x1d77 0x2c8c 0x9aec 0x1c5a 0x2e23 0x9a9a 0x1afe 0x2fba 0x9a34 0x1c84 0x3151 0x99e3 0x1c4e 0x32e9 0x999c 0x1d21 0x3480 0x995f 0x1c9b 0x3617 0x9912 0x1c40 0x37af 0x98cb 0x1cd3 0x3946 0x9881 0x1cb9 0x3add 0x9834 0x1ca1 0x3c74 0x97ed 0x1c8a 0x3e0c 0x97a6 0x1c80 0x3fa3 0x9760 0x1c7a 0x413a 0x9719 0x1c7a 0x42d1 0x96d7 0x1c7a 0x4469 0x9696 0x1c87 0x4600 0x9653 0x1c8f 0x4797 0x961b 0x1c92 0x492f 0x95e4 0x1ca7 0x4ac6 0x95ac 0x1cc8 0x4c5d 0x9543 0x1cf2 0x4df4 0x9515 0x1d0b 0x4f8c 0x94e8 0x1d24 0x5123 0x94bf 0x1d33 0x52ba 0x9497 0x1d48 0x5451 0x946f 0x1d6b 0x55e9 0x944c 0x1d99 0x5780 0x9433 0x1dcc 0x5917 0x941f 0x1ded 0x5aaf 0x940a 0x1e19 0x5c46 0x93f0 0x1e5b 0x5ddd 0x93de 0x1ea2 0x5f74 0x93c8 0x1ef5 0x610c 0x93b6 0x1f5c 0x62a3 0x93a5 0x1fb8 0x643a 0x9391 0x2035 0x65d1 0x937d 0x20ba 0x6769 0x9369 0x2133 0x6900 0x9355 0x219f 0x6a97 0x9340 0x2211 0x6c2f 0x932c 0x22a6 0x6dc6 0x9318 0x234e 0x6f5d 0x9304 0x23fa 0x70f4 0x92e8 0x24bb 0x728c 0x92d1 0x2570 0x7423 0x92b6 0x264f 0x75ba 0x9298 0x271c 0x7751 0x9279 0x27fa 0x78e9 0x9253 0x28cc 0x7a80 0x9233 0x29c4 0x7c17 0x9214 0x2ab3 0x7daf 0x91ee 0x2bbb 0x7f46 0x919e 0x2df8 0x80dd 0x9175 0x2f2a 0x8274 0x9145 0x305a 0x840c 0x911a 0x31b3 0x85a3 0x90ea 0x32fc 0x873a 0x90b7 0x3447 0x88d1 0x908d 0x3583 0x8a69 0x905c 0x36d7 0x8c00 0x902a 0x381c 0x8d97 0x8ff7 0x398d 0x8f2f 0x8fbb 0x3ad5 0x90c6 0x8f7f 0x3c06 0x925d 0x8f30 0x3d3e 0x93f4 0x8ecc 0x3e77 0x958c 0x8e41 0x3fb0 0x9723 0x8d84 0x40f3 0x98ba 0x8c6c 0x4253 0x9a51 0x8ae6 0x4417 0x9be9 0x88be 0x46a3 0x9d80 0x857a 0x4a74>;
		linux,phandle = <0x79>;
		phandle = <0x79>;
	};

	topmisc@10011000 {
		compatible = "mediatek,topmisc";
		reg = <0x00 0x10011000 0x00 0x1000>;
	};

	dvfsrc@10012000 {
		compatible = "mediatek,dvfsrc";
		reg = <0x00 0x10012000 0x00 0x1000 0x00 0x110780 0x00 0x80>;
	};

	mbist_ao@10013000 {
		compatible = "mediatek,mbist_ao";
		reg = <0x00 0x10013000 0x00 0x1000>;
	};

	apcldmain_ao@10014000 {
		compatible = "mediatek,apcldmain_ao";
		reg = <0x00 0x10014000 0x00 0x400>;
	};

	apcldmaout_ao@10014400 {
		compatible = "mediatek,apcldmaout_ao";
		reg = <0x00 0x10014400 0x00 0x400>;
	};

	apcldmamisc_ao@10014800 {
		compatible = "mediatek,apcldmamisc_ao";
		reg = <0x00 0x10014800 0x00 0x400>;
	};

	ddrphy@10015000 {
		compatible = "mediatek,ddrphy";
		reg = <0x00 0x10015000 0x00 0x1000>;
	};

	aes_top0@10016000 {
		compatible = "mediatek,aes_top0";
		reg = <0x00 0x10016000 0x00 0x1000>;
	};

	sys_timer@10017000 {
		compatible = "mediatek,sys_timer";
		reg = <0x00 0x10017000 0x00 0x1000>;
		reg-names = "sys_timer_base";
		interrupts = <0x00 0xc2 0x04>;
	};

	modem_temp_share@10018000 {
		compatible = "mediatek,modem_temp_share";
		reg = <0x00 0x10018000 0x00 0x1000>;
	};

	security_ao@1001a000 {
		compatible = "mediatek,security_ao";
		reg = <0x00 0x1001a000 0x00 0x1000>;
	};

	topckgen_ao@1001b000 {
		compatible = "mediatek,topckgen_ao";
		reg = <0x00 0x1001b000 0x00 0x1000>;
	};

	dramc0@1001d000 {
		compatible = "mediatek,dramc0";
		reg = <0x00 0x1001d000 0x00 0x1000>;
	};

	ddrphy@1001e000 {
		compatible = "mediatek,ddrphy";
		reg = <0x00 0x1001e000 0x00 0x1000>;
	};

	iocfg_0@10002000 {
		compatible = "mediatek,iocfg_0";
		reg = <0x00 0x10002000 0x00 0x200>;
	};

	iocfg_1@10002200 {
		compatible = "mediatek,iocfg_1";
		reg = <0x00 0x10002200 0x00 0x200>;
	};

	iocfg_2@10002400 {
		compatible = "mediatek,iocfg_2";
		reg = <0x00 0x10002400 0x00 0x200>;
	};

	iocfg_3@10002600 {
		compatible = "mediatek,iocfg_3";
		reg = <0x00 0x10002600 0x00 0x200>;
	};

	iocfg_4@10002800 {
		compatible = "mediatek,iocfg_4";
		reg = <0x00 0x10002800 0x00 0x200>;
	};

	iocfg_5@10002a00 {
		compatible = "mediatek,iocfg_5";
		reg = <0x00 0x10002a00 0x00 0x200>;
	};

	mdcldmain_ao@10015000 {
		compatible = "mediatek,mdcldmain_ao";
		reg = <0x00 0x10015000 0x00 0x400>;
	};

	mdcldmaout_ao@10015400 {
		compatible = "mediatek,mdcldmaout_ao";
		reg = <0x00 0x10015400 0x00 0x400>;
	};

	mdcldmamisc_ao@10015800 {
		compatible = "mediatek,mdcldmamisc_ao";
		reg = <0x00 0x10015800 0x00 0x400>;
	};

	sys_cirq@10204000 {
		compatible = "mediatek,sys_cirq";
		reg = <0x00 0x10204000 0x00 0x1000>;
		mediatek,cirq_num = <0xd1>;
		mediatek,spi_start_offset = <0x48>;
		interrupts = <0x00 0x118 0x08>;
	};

	mcucfg@10200000 {
		compatible = "mediatek,mcucfg";
		reg = <0x00 0x10200000 0x00 0x1000>;
		interrupts = <0x00 0x00 0x08>;
	};

	mcucfg_mp0_counter@10200000 {
		compatible = "mediatek,mcucfg_mp0_counter";
		reg = <0x00 0x10200000 0x00 0x4000>;
	};

	m4u@10205000 {
		cell-index = <0x00>;
		compatible = "mediatek,iommu_v0";
		reg = <0x00 0x10205000 0x00 0x1000>;
		mediatek,larbs = <0x20 0x21 0x22 0x23>;
		interrupts = <0x00 0x9e 0x08>;
		#iommu-cells = <0x01>;
		linux,phandle = <0x4b>;
		phandle = <0x4b>;
	};

	devapc@10207000 {
		compatible = "mediatek,devapc";
		reg = <0x00 0x10207000 0x00 0x1000 0x00 0x1000e000 0x00 0x1000>;
		interrupts = <0x00 0x8e 0x08>;
		clocks = <0x24 0x28>;
		clock-names = "devapc-infra-clock";
	};

	bus_dbg@10208000 {
		compatible = "mediatek,bus_dbg-v2";
		reg = <0x00 0x10208000 0x00 0x1000 0x00 0x10001000 0x00 0x1000>;
		mediatek,bus_dbg_con_offset = <0x2fc>;
		interrupts = <0x00 0x8d 0x08>;
	};

	ap_ccif0@10209000 {
		compatible = "mediatek,ap_ccif0";
		reg = <0x00 0x10209000 0x00 0x1000>;
		interrupts = <0x00 0x94 0x08>;
	};

	md_ccif0@1020a000 {
		compatible = "mediatek,md_ccif0";
		reg = <0x00 0x1020a000 0x00 0x1000>;
	};

	ap_ccif1@1020b000 {
		compatible = "mediatek,ap_ccif1";
		reg = <0x00 0x1020b000 0x00 0x1000>;
		interrupts = <0x00 0x96 0x08>;
	};

	md_ccif1@1020c000 {
		compatible = "mediatek,md_ccif1";
		reg = <0x00 0x1020c000 0x00 0x1000>;
	};

	infra_mbist@1020d000 {
		compatible = "mediatek,infra_mbist";
		reg = <0x00 0x1020d000 0x00 0x1000>;
	};

	infracfg@1020e000 {
		compatible = "mediatek,infracfg";
		reg = <0x00 0x1020e000 0x00 0x1000>;
	};

	trng@1020f000 {
		compatible = "mediatek,trng";
		reg = <0x00 0x1020f000 0x00 0x1000>;
		interrupts = <0x00 0xa1 0x08>;
	};

	dxcc_sec@10210000 {
		compatible = "mediatek,dxcc_sec";
		reg = <0x00 0x10210000 0x00 0x1000>;
		interrupts = <0x00 0xa2 0x04>;
	};

	mcupm_sram2@10211000 {
		compatible = "mediatek,mcupm_sram2";
		reg = <0x00 0x10211000 0x00 0x1000>;
	};

	cq_dma@10212000 {
		compatible = "mediatek,mt-cqdma-v1";
		reg = <0x00 0x10212000 0x00 0x80 0x00 0x10212080 0x00 0x80>;
		interrupts = <0x00 0x71 0x08 0x00 0x72 0x08>;
		nr_channel = <0x02>;
		keep_clock_ao = "yes";
		clocks = <0x24 0x43>;
		clock-names = "cqdma";
	};

	mcupm_sram3@10213000 {
		compatible = "mediatek,mcupm_sram3";
		reg = <0x00 0x10213000 0x00 0x1000>;
	};

	sramrom@10214000 {
		compatible = "mediatek,sramrom";
		reg = <0x00 0x10214000 0x00 0x1000>;
	};

	mcupm_reg@10216000 {
		compatible = "mediatek,mcupm_reg";
		reg = <0x00 0x10216000 0x00 0x1000>;
	};

	mcupm_sram0@10217000 {
		compatible = "mediatek,mcupm_sram0";
		reg = <0x00 0x10217000 0x00 0x1000>;
	};

	mcupm_sram1@10218000 {
		compatible = "mediatek,mcupm_sram1";
		reg = <0x00 0x10218000 0x00 0x1000>;
	};

	emi@10219000 {
		compatible = "mediatek,emi";
		reg = <0x00 0x10219000 0x00 0x1000 0x00 0x10226000 0x00 0x1000 0x00 0x1022d000 0x00 0x1000 0x00 0x10235000 0x00 0x1000>;
		interrupts = <0x00 0x90 0x08>;
	};

	apcldmain@1021b000 {
		compatible = "mediatek,apcldmain";
		reg = <0x00 0x1021b000 0x00 0x00>;
	};

	apcldmaout@1021b400 {
		compatible = "mediatek,apcldmaout";
		reg = <0x00 0x1021b400 0x00 0x00>;
	};

	apcldmamisc@1021b800 {
		compatible = "mediatek,apcldmamisc";
		reg = <0x00 0x1021b800 0x00 0x00>;
		interrupts = <0x00 0xa5 0x04>;
	};

	mdcldmain@1021c000 {
		compatible = "mediatek,mdcldmain";
		reg = <0x00 0x1021c000 0x00 0x400>;
	};

	mdcldmaout@1021c400 {
		compatible = "mediatek,mdcldmaout";
		reg = <0x00 0x1021c400 0x00 0x400>;
	};

	mdcldmamisc@1021c800 {
		compatible = "mediatek,mdcldmamisc";
		reg = <0x00 0x1021c800 0x00 0x1000>;
	};

	mdcldma@10014000 {
		compatible = "mediatek,mdcldma";
		reg = <0x00 0x10014000 0x00 0x1000 0x00 0x1021b000 0x00 0x1000 0x00 0x10209000 0x00 0x1000 0x00 0x1020a000 0x00 0x1000>;
		interrupts = <0x00 0xa5 0x04 0x00 0x94 0x08 0x00 0x95 0x08 0x00 0x105 0x02>;
		mediatek,md_id = <0x00>;
		mediatek,cldma_capability = <0x06>;
		clocks = <0x25 0x00 0x24 0x32 0x24 0x29 0x24 0x2c 0x24 0x23 0x24 0x24 0x24 0x51 0x24 0x52>;
		clock-names = "scp-sys-md1-main\0infra-cldma-bclk\0infra-ccif-ap\0infra-ccif-md\0infra-ccif1-ap\0infra-ccif1-md\0infra-ccif2-ap\0infra-ccif2-md";
		linux,phandle = <0x1c>;
		phandle = <0x1c>;
	};

	dramc_nao@1021d000 {
		compatible = "mediatek,dramc_nao";
		reg = <0x00 0x1021d000 0x00 0x1000>;
	};

	bpi_bsi_slv0@1021e000 {
		compatible = "mediatek,bpi_bsi_slv0";
		reg = <0x00 0x1021e000 0x00 0x1000>;
	};

	bpi_bsi_slv1@1021f000 {
		compatible = "mediatek,bpi_bsi_slv1";
		reg = <0x00 0x1021f000 0x00 0x6000>;
	};

	bpi_bsi_slv2@10225000 {
		compatible = "mediatek,bpi_bsi_slv2";
		reg = <0x00 0x10225000 0x00 0x1000>;
	};

	dvfsp@10227000 {
		compatible = "mediatek,dvfsp";
		reg = <0x00 0x10227000 0x00 0x1000>;
	};

	dvfsp@00110800 {
		compatible = "mediatek,mt6765-dvfsp";
		reg = <0x00 0x110800 0x00 0x1400 0x00 0x110800 0x00 0x1400>;
	};

	eem_fsm@1100b000 {
		compatible = "mediatek,eem_fsm";
		reg = <0x00 0x1100b000 0x00 0x1000>;
		interrupts = <0x00 0x7d 0x08>;
	};

	dramc@1022a000 {
		compatible = "mediatek,dramc";
		reg = <0x00 0x1022a000 0x00 0x2000 0x00 0x10232000 0x00 0x2000 0x00 0x1022c000 0x00 0x1000 0x00 0x10234000 0x00 0x1000 0x00 0x10228000 0x00 0x2000 0x00 0x10230000 0x00 0x2000 0x00 0x1022e000 0x00 0x1000 0x00 0x10236000 0x00 0x1000>;
	};

	gce@10238000 {
		compatible = "mediatek,gce\0syscon";
		reg = <0x00 0x10238000 0x00 0x4000>;
		#clock-cells = <0x01>;
		interrupts = <0x00 0x9a 0x08 0x00 0x9b 0x08>;
		g3d_config_base = <0x13000000 0x00 0xffff0000>;
		mmsys_config_base = <0x14000000 0x01 0xffff0000>;
		disp_dither_base = <0x14010000 0x02 0xffff0000>;
		mm_na_base = <0x14020000 0x03 0xffff0000>;
		imgsys_base = <0x15020000 0x04 0xffff0000>;
		vdec_gcon_base = <0x18800000 0x05 0xffff0000>;
		venc_gcon_base = <0x18810000 0x06 0xffff0000>;
		conn_peri_base = <0x18820000 0x07 0xffff0000>;
		topckgen_base = <0x18830000 0x08 0xffff0000>;
		kp_base = <0x18840000 0x09 0xffff0000>;
		scp_sram_base = <0x10000000 0x0a 0xffff0000>;
		infra_na3_base = <0x10010000 0x0b 0xffff0000>;
		infra_na4_base = <0x10020000 0x0c 0xffff0000>;
		scp_base = <0x10030000 0x0d 0xffff0000>;
		mcucfg_base = <0x10040000 0x0e 0xffff0000>;
		gcpu_base = <0x10050000 0x0f 0xffff0000>;
		usb0_base = <0x10200000 0x10 0xffff0000>;
		usb_sif_base = <0x10280000 0x11 0xffff0000>;
		audio_base = <0x17000000 0x12 0xffff0000>;
		vdec_base = <0x17010000 0x13 0xffff0000>;
		msdc2_base = <0x17020000 0x14 0xffff0000>;
		vdec1_base = <0x17030000 0x15 0xffff0000>;
		msdc3_base = <0x18000000 0x16 0xffff0000>;
		ap_dma_base = <0x18010000 0x17 0xffff0000>;
		gce_base = <0x18020000 0x18 0xffff0000>;
		vdec2_base = <0x18040000 0x19 0xffff0000>;
		vdec3_base = <0x18050000 0x1a 0xffff0000>;
		camsys_base = <0x18080000 0x1b 0xffff0000>;
		camsys1_base = <0x180a0000 0x1c 0xffff0000>;
		camsys2_base = <0x180b0000 0x1d 0xffff0000>;
		pwm_sw_base = <0x1100e000 0x63 0xffff0000>;
		mipitx0_base = <0x11c80000 0x63 0xffff0000>;
		mdp_rdma0_sof = <0x00>;
		mdp_ccorr0_sof = <0x01>;
		mdp_rsz0_sof = <0x02>;
		mdp_rsz1_sof = <0x03>;
		mdp_wdma_sof = <0x04>;
		mdp_wrot0_sof = <0x05>;
		mdp_tdshp0_sof = <0x06>;
		disp_ovl0_sof = <0x07>;
		disp_2l_ovl0_sof = <0x08>;
		disp_rdma0_sof = <0x09>;
		disp_wdma0_sof = <0x0a>;
		disp_color0_sof = <0x0b>;
		disp_ccorr0_sof = <0x0c>;
		disp_aal0_sof = <0x0d>;
		disp_gamma0_sof = <0x0e>;
		disp_dither0_sof = <0x0f>;
		disp_dsi0_sof = <0x10>;
		disp_rsz0_sof = <0x11>;
		img_dl_relay_sof = <0x12>;
		disp_pwm0_sof = <0x13>;
		mdp_rdma0_frame_done = <0x14>;
		mdp_ccorr0_frame_done = <0x15>;
		mdp_rsz0_frame_done = <0x16>;
		mdp_rsz1_frame_done = <0x17>;
		mdp_wrot0_write_frame_done = <0x18>;
		mdp_wdma_frame_done = <0x19>;
		mdp_tdshp0_frame_done = <0x1a>;
		disp_ovl0_frame_done = <0x1b>;
		disp_2l_ovl0_frame_done = <0x1c>;
		disp_rsz0_frame_done = <0x1d>;
		disp_rdma0_frame_done = <0x1e>;
		disp_wdma0_frame_done = <0x1f>;
		disp_color0_frame_done = <0x20>;
		disp_ccorr0_frame_done = <0x21>;
		disp_aal0_frame_done = <0x22>;
		disp_gamma0_frame_done = <0x23>;
		disp_dither0_frame_done = <0x24>;
		disp_dsi0_frame_done = <0x25>;
		stream_done_0 = <0x82>;
		stream_done_1 = <0x83>;
		stream_done_2 = <0x84>;
		stream_done_3 = <0x85>;
		stream_done_4 = <0x86>;
		stream_done_5 = <0x87>;
		stream_done_6 = <0x88>;
		stream_done_7 = <0x89>;
		stream_done_8 = <0x8a>;
		stream_done_9 = <0x8b>;
		buf_underrun_event_0 = <0x8c>;
		dsi0_te_event = <0x8d>;
		dsi0_irq_event = <0x8e>;
		dsi0_done_event = <0x8f>;
		disp_wdma0_rst_done = <0x93>;
		mdp_wdma_rst_done = <0x94>;
		mdp_wrot0_rst_done = <0x95>;
		mdp_rdma0_rst_done = <0x97>;
		disp_ovl0_frame_rst_done_pusle = <0x98>;
		dip_cq_thread0_frame_done = <0x101>;
		dip_cq_thread1_frame_done = <0x102>;
		dip_cq_thread2_frame_done = <0x103>;
		dip_cq_thread3_frame_done = <0x104>;
		dip_cq_thread4_frame_done = <0x105>;
		dip_cq_thread5_frame_done = <0x106>;
		dip_cq_thread6_frame_done = <0x107>;
		dip_cq_thread7_frame_done = <0x108>;
		dip_cq_thread8_frame_done = <0x109>;
		dip_cq_thread9_frame_done = <0x10a>;
		dip_cq_thread10_frame_done = <0x10b>;
		dip_cq_thread11_frame_done = <0x10c>;
		dip_cq_thread12_frame_done = <0x10d>;
		dip_cq_thread13_frame_done = <0x10e>;
		dip_cq_thread14_frame_done = <0x10f>;
		dip_cq_thread15_frame_done = <0x110>;
		dip_cq_thread16_frame_done = <0x111>;
		dip_cq_thread17_frame_done = <0x112>;
		dip_cq_thread18_frame_done = <0x113>;
		dve_frame_done = <0x114>;
		wmf_frame_done = <0x115>;
		rsc_frame_done = <0x116>;
		venc_done = <0x121>;
		jpgenc_done = <0x122>;
		jpgdec_done = <0x123>;
		venc_mb_done = <0x124>;
		venc_128byte_cnt_done = <0x125>;
		max_prefetch_cnt = <0x01>;
		prefetch_size = <0x60>;
		sram_size_cpr_64 = <0x40>;
		mmsys_config = <0x26>;
		mdp_rdma0 = <0x27>;
		mdp_rsz0 = <0x28>;
		mdp_rsz1 = <0x29>;
		mdp_wdma0 = <0x2a>;
		mdp_wrot0 = <0x2b>;
		mdp_tdshp0 = <0x2c>;
		mdp_color0 = <0x2d>;
		mdp_ccorr0 = <0x2e>;
		mm_mutex = <0x2f>;
		sram_share_cnt = <0x01>;
		sram_share_engine = <0x0a>;
		sram_share_event = <0x2c6>;
		clocks = <0x24 0x09 0x24 0x18>;
		clock-names = "GCE\0GCE_TIMER";
		mediatek,mailbox-gce = <0x30>;
		thread_count = <0x10>;
		secure_thread = <0x08 0x0a>;
		mboxes = <0x30 0x00 0x00 0x04 0x30 0x01 0x00 0x04 0x30 0x02 0x00 0x05 0x30 0x03 0x00 0x04 0x30 0x04 0x00 0x04 0x30 0x05 0x00 0x04 0x30 0x06 0x00 0x03 0x30 0x07 0xffffffff 0x02 0x30 0x08 0x00 0x01 0x30 0x09 0x00 0x01 0x30 0x0a 0x00 0x01 0x30 0x0b 0x00 0x01 0x30 0x0c 0x00 0x01 0x30 0x0d 0x00 0x01 0x30 0x0e 0x00 0x01 0x30 0x0f 0x00 0x01>;
		linux,phandle = <0x7a>;
		phandle = <0x7a>;
	};

	gce_mbox@10238000 {
		compatible = "mediatek,mailbox-gce";
		reg = <0x00 0x10238000 0x00 0x4000>;
		interrupts = <0x00 0x9a 0x08 0x00 0x9b 0x08>;
		#mbox-cells = <0x03>;
		#gce-event-cells = <0x01>;
		#gce-subsys-cells = <0x02>;
		clocks = <0x24 0x09 0x24 0x18>;
		clock-names = "gce\0GCE_TIMER";
		linux,phandle = <0x30>;
		phandle = <0x30>;
	};

	gce_mbox_svp@10238000 {
		compatible = "mediatek,mailbox-gce-svp";
		reg = <0x00 0x10238000 0x00 0x4000>;
		interrupts = <0x00 0x9a 0x08 0x00 0x9b 0x08>;
		#mbox-cells = <0x03>;
		clocks = <0x24 0x09 0x24 0x18>;
		clock-names = "gce\0GCE_TIMER";
		linux,phandle = <0x7b>;
		phandle = <0x7b>;
	};

	ap_ccif2@1023c000 {
		compatible = "mediatek,ap_ccif2";
		reg = <0x00 0x1023c000 0x00 0x1000>;
		interrupts = <0x00 0x8f 0x08>;
	};

	md_ccif2@1023d000 {
		compatible = "mediatek,md_ccif2";
		reg = <0x00 0x1023d000 0x00 0x1000>;
	};

	ap_ccif3@1023e000 {
		compatible = "mediatek,ap_ccif3";
		reg = <0x00 0x1023e000 0x00 0x1000>;
		interrupts = <0x00 0x92 0x08>;
	};

	md_ccif3@1023f000 {
		compatible = "mediatek,md_ccif3";
		reg = <0x00 0x1023f000 0x00 0x1000>;
	};

	sspm@10440000 {
		compatible = "mediatek,sspm";
		reg = <0x00 0x10440000 0x00 0x10000 0x00 0x10450000 0x00 0x100 0x00 0x10451000 0x00 0x08 0x00 0x10460000 0x00 0x100 0x00 0x10461000 0x00 0x08 0x00 0x10470000 0x00 0x100 0x00 0x10471000 0x00 0x08 0x00 0x10480000 0x00 0x100 0x00 0x10481000 0x00 0x08 0x00 0x10490000 0x00 0x100 0x00 0x10491000 0x00 0x08>;
		reg-names = "cfgreg\0mbox0_base\0mbox0_ctrl\0mbox1_base\0mbox1_ctrl\0mbox2_base\0mbox2_ctrl\0mbox3_base\0mbox3_ctrl\0mbox4_base\0mbox4_ctrl";
		interrupts = <0x00 0xca 0x04 0x00 0xcd 0x04 0x00 0xce 0x04 0x00 0xcf 0x04 0x00 0xd0 0x04 0x00 0xd1 0x04>;
		interrupt-names = "ipc\0mbox0\0mbox1\0mbox2\0mbox3\0mbox4";
	};

	gic500@0c000000 {
		compatible = "mediatek,gic500";
		reg = <0x00 0xc000000 0x00 0x1000>;
	};

	gic_cpu@0c400000 {
		compatible = "mediatek,gic_cpu";
		reg = <0x00 0xc400000 0x00 0x40000>;
	};

	dfd@10200b00 {
		compatible = "mediatek,dfd";
		reg = <0x00 0x10200b00 0x00 0x10000>;
		mediatek,enabled = <0x01>;
		mediatek,chain_length = <0xc350>;
		mediatek,rg_dfd_timeout = <0xa0>;
	};

	dbg_cti@0d020000 {
		compatible = "mediatek,dbg_cti";
		reg = <0x00 0xd020000 0x00 0x10000>;
	};

	dbg_etr@0d030000 {
		compatible = "mediatek,dbg_etr";
		reg = <0x00 0xd030000 0x00 0x10000>;
	};

	dbg_funnel@0d040000 {
		compatible = "mediatek,dbg_funnel";
		reg = <0x00 0xd040000 0x00 0x10000>;
	};

	dbg_dem@0d0a0000 {
		compatible = "mediatek,dbg_dem";
		reg = <0x00 0xd0a0000 0x00 0x10000>;
		interrupts = <0x00 0x8c 0x08>;
	};

	dbg_mdsys1@0d0c0000 {
		compatible = "mediatek,dbg_mdsys1";
		reg = <0x00 0xd0c0000 0x00 0x40000>;
	};

	dbg_apmcu_mp0@0d400000 {
		compatible = "mediatek,dbg_apmcu_mp0";
		reg = <0x00 0xd400000 0x00 0x1000>;
	};

	dbg_apmcu_mp0@0d410000 {
		compatible = "mediatek,dbg_apmcu_mp0";
		reg = <0x00 0xd410000 0x00 0x1000>;
	};

	dbg_apmcu_mp0@0d420000 {
		compatible = "mediatek,dbg_apmcu_mp0";
		reg = <0x00 0xd420000 0x00 0x1000>;
	};

	dbg_apmcu_mp0@0d430000 {
		compatible = "mediatek,dbg_apmcu_mp0";
		reg = <0x00 0xd430000 0x00 0x1000>;
	};

	dbg_apmcu_mp0@0d440000 {
		compatible = "mediatek,dbg_apmcu_mp0";
		reg = <0x00 0xd440000 0x00 0x1000>;
	};

	dbg_apmcu_mp0@0d510000 {
		compatible = "mediatek,dbg_apmcu_mp0";
		reg = <0x00 0xd510000 0x00 0x1000>;
	};

	dbg_apmcu_mp0@0d520000 {
		compatible = "mediatek,dbg_apmcu_mp0";
		reg = <0x00 0xd520000 0x00 0x1000>;
	};

	dbg_apmcu_mp0@0d530000 {
		compatible = "mediatek,dbg_apmcu_mp0";
		reg = <0x00 0xd530000 0x00 0x1000>;
	};

	dbg_apmcu_mp0@0d540000 {
		compatible = "mediatek,dbg_apmcu_mp0";
		reg = <0x00 0xd540000 0x00 0x1000>;
	};

	dbg_apmcu_mp0@0d610000 {
		compatible = "mediatek,dbg_apmcu_mp0";
		reg = <0x00 0xd610000 0x00 0x1000>;
	};

	dbg_apmcu_mp0@0d620000 {
		compatible = "mediatek,dbg_apmcu_mp0";
		reg = <0x00 0xd620000 0x00 0x1000>;
	};

	dbg_apmcu_mp0@0d630000 {
		compatible = "mediatek,dbg_apmcu_mp0";
		reg = <0x00 0xd630000 0x00 0x1000>;
	};

	dbg_apmcu_mp0@0d640000 {
		compatible = "mediatek,dbg_apmcu_mp0";
		reg = <0x00 0xd640000 0x00 0x1000>;
	};

	dbg_apmcu_mp0@0d710000 {
		compatible = "mediatek,dbg_apmcu_mp0";
		reg = <0x00 0xd710000 0x00 0x1000>;
	};

	dbg_apmcu_mp0@0d720000 {
		compatible = "mediatek,dbg_apmcu_mp0";
		reg = <0x00 0xd720000 0x00 0x1000>;
	};

	dbg_apmcu_mp0@0d730000 {
		compatible = "mediatek,dbg_apmcu_mp0";
		reg = <0x00 0xd730000 0x00 0x1000>;
	};

	dbg_apmcu_mp0@0d740000 {
		compatible = "mediatek,dbg_apmcu_mp0";
		reg = <0x00 0xd740000 0x00 0x1000>;
	};

	dbg_apmcu_mp1@0d800000 {
		compatible = "mediatek,dbg_apmcu_mp1";
		reg = <0x00 0xd800000 0x00 0x1000>;
	};

	dbg_apmcu_mp1@0d810000 {
		compatible = "mediatek,dbg_apmcu_mp1";
		reg = <0x00 0xd810000 0x00 0x1000>;
	};

	dbg_apmcu_mp1@0d820000 {
		compatible = "mediatek,dbg_apmcu_mp1";
		reg = <0x00 0xd820000 0x00 0x1000>;
	};

	dbg_apmcu_mp1@0d830000 {
		compatible = "mediatek,dbg_apmcu_mp1";
		reg = <0x00 0xd830000 0x00 0x1000>;
	};

	dbg_apmcu_mp1@0d840000 {
		compatible = "mediatek,dbg_apmcu_mp1";
		reg = <0x00 0xd840000 0x00 0x1000>;
	};

	dbg_apmcu_mp1@0d910000 {
		compatible = "mediatek,dbg_apmcu_mp1";
		reg = <0x00 0xd910000 0x00 0x1000>;
	};

	dbg_apmcu_mp1@0d920000 {
		compatible = "mediatek,dbg_apmcu_mp1";
		reg = <0x00 0xd920000 0x00 0x1000>;
	};

	dbg_apmcu_mp1@0d930000 {
		compatible = "mediatek,dbg_apmcu_mp1";
		reg = <0x00 0xd930000 0x00 0x1000>;
	};

	dbg_apmcu_mp1@0d940000 {
		compatible = "mediatek,dbg_apmcu_mp1";
		reg = <0x00 0xd940000 0x00 0x1000>;
	};

	dbg_apmcu_mp1@0da10000 {
		compatible = "mediatek,dbg_apmcu_mp1";
		reg = <0x00 0xda10000 0x00 0x1000>;
	};

	dbg_apmcu_mp1@0da20000 {
		compatible = "mediatek,dbg_apmcu_mp1";
		reg = <0x00 0xda20000 0x00 0x1000>;
	};

	dbg_apmcu_mp1@0da30000 {
		compatible = "mediatek,dbg_apmcu_mp1";
		reg = <0x00 0xda30000 0x00 0x1000>;
	};

	dbg_apmcu_mp1@0da40000 {
		compatible = "mediatek,dbg_apmcu_mp1";
		reg = <0x00 0xda40000 0x00 0x1000>;
	};

	dbg_apmcu_mp1@0db10000 {
		compatible = "mediatek,dbg_apmcu_mp1";
		reg = <0x00 0xdb10000 0x00 0x1000>;
	};

	dbg_apmcu_mp1@0db20000 {
		compatible = "mediatek,dbg_apmcu_mp1";
		reg = <0x00 0xdb20000 0x00 0x1000>;
	};

	dbg_apmcu_mp1@0db30000 {
		compatible = "mediatek,dbg_apmcu_mp1";
		reg = <0x00 0xdb30000 0x00 0x1000>;
	};

	dbg_apmcu_mp1@0db40000 {
		compatible = "mediatek,dbg_apmcu_mp1";
		reg = <0x00 0xdb40000 0x00 0x1000>;
	};

	ap_dma@11000000 {
		compatible = "mediatek,ap_dma";
		reg = <0x00 0x11000000 0x00 0x1000>;
		interrupts = <0x00 0x61 0x08>;
	};

	auxadc@11001000 {
		compatible = "mediatek,auxadc";
		reg = <0x00 0x11001000 0x00 0x10000>;
		interrupts = <0x00 0x4c 0x02>;
		clocks = <0x24 0x21>;
		clock-names = "auxadc-main";
		linux,phandle = <0x7c>;
		phandle = <0x7c>;
	};

	dma-controller@11000580 {
		compatible = "mediatek,mt6577-uart-dma";
		reg = <0x00 0x11000680 0x00 0x80 0x00 0x11000700 0x00 0x80 0x00 0x11000780 0x00 0x80 0x00 0x11000800 0x00 0x80>;
		interrupts = <0x00 0x6d 0x08 0x00 0x6e 0x08 0x00 0x6f 0x08 0x00 0x74 0x08>;
		clocks = <0x24 0x26>;
		clock-names = "apdma";
		#dma-cells = <0x01>;
		linux,phandle = <0x31>;
		phandle = <0x31>;
	};

	serial@11020000 {
		compatible = "mediatek,mt6758-uart\0mediatek,mt6577-uart";
		reg = <0x00 0x11002000 0x00 0x1000>;
		interrupts = <0x00 0x5b 0x08>;
		clocks = <0x1f 0x24 0x16>;
		clock-names = "baud\0bus";
		dmas = <0x31 0x00 0x31 0x01>;
		dma-names = "tx\0rx";
		linux,phandle = <0x7d>;
		phandle = <0x7d>;
	};

	serial@11030000 {
		compatible = "mediatek,mt6758-uart\0mediatek,mt6577-uart";
		reg = <0x00 0x11003000 0x00 0x1000>;
		interrupts = <0x00 0x5c 0x08>;
		clocks = <0x1f 0x24 0x17>;
		clock-names = "baud\0bus";
		linux,phandle = <0x7e>;
		phandle = <0x7e>;
	};

	i2c_common {
		compatible = "mediatek,i2c_common";
		dma_support = [02];
		idvfs = [01];
		set_dt_div = [01];
		check_max_freq = [01];
		ver = [02];
		set_ltiming = [01];
		ext_time_config = [18 01];
		cnt_constraint = [01];
		linux,phandle = <0x7f>;
		phandle = <0x7f>;
	};

	i2c0@11007000 {
		compatible = "mediatek,i2c";
		id = <0x00>;
		reg = <0x00 0x11007000 0x00 0x1000 0x00 0x11000080 0x00 0x80>;
		interrupts = <0x00 0x54 0x08>;
		clocks = <0x24 0x0b 0x24 0x26>;
		clock-names = "main\0dma";
		clock-div = <0x05>;
		scl-gpio-id = <0x53>;
		sda-gpio-id = <0x52>;
		gpio_start = <0x10002a00>;
		mem_len = <0x200>;
		eh_cfg = <0x20>;
		pu_cfg = <0x50>;
		rsel_cfg = <0x70>;
		aed = <0x1a>;
		mediatek,hs_only;
		linux,phandle = <0x80>;
		phandle = <0x80>;
	};

	i2c1@11008000 {
		compatible = "mediatek,i2c";
		id = <0x01>;
		reg = <0x00 0x11008000 0x00 0x1000 0x00 0x11000100 0x00 0x80>;
		interrupts = <0x00 0x55 0x08>;
		clocks = <0x24 0x0b 0x24 0x26>;
		clock-names = "main\0dma";
		clock-div = <0x05>;
		scl-gpio-id = <0x54>;
		sda-gpio-id = <0x51>;
		gpio_start = <0x10002a00>;
		mem_len = <0x200>;
		eh_cfg = <0x20>;
		pu_cfg = <0x50>;
		rsel_cfg = <0x70>;
		aed = <0x1a>;
		mediatek,hs_only;
		linux,phandle = <0x81>;
		phandle = <0x81>;
	};

	i2c2@11009000 {
		compatible = "mediatek,i2c";
		id = <0x02>;
		reg = <0x00 0x11009000 0x00 0x1000 0x00 0x11000180 0x00 0x180>;
		interrupts = <0x00 0x56 0x08>;
		clocks = <0x24 0x0b 0x24 0x26>;
		clock-names = "main\0dma";
		clock-div = <0x05>;
		scl-gpio-id = <0x67>;
		sda-gpio-id = <0x68>;
		gpio_start = <0x10002800>;
		mem_len = <0x200>;
		eh_cfg = <0x20>;
		pu_cfg = <0x60>;
		rsel_cfg = <0xa0>;
		aed = <0x1a>;
		ch_offset_default = <0x100>;
		ch_offset_ccu = <0x200>;
		mediatek,hs_only;
		linux,phandle = <0x82>;
		phandle = <0x82>;
	};

	i2c3@1100f000 {
		compatible = "mediatek,i2c";
		id = <0x03>;
		reg = <0x00 0x1100f000 0x00 0x1000 0x00 0x11000300 0x00 0x100>;
		interrupts = <0x00 0x57 0x08>;
		clocks = <0x24 0x0b 0x24 0x26>;
		clock-names = "main\0dma";
		clock-div = <0x05>;
		scl-gpio-id = <0x32>;
		sda-gpio-id = <0x33>;
		gpio_start = <0x10002600>;
		mem_len = <0x200>;
		eh_cfg = <0x20>;
		pu_cfg = <0x90>;
		rsel_cfg = <0xb0>;
		aed = <0x1a>;
		ch_offset_default = <0x100>;
		mediatek,hs_only;
		linux,phandle = <0x83>;
		phandle = <0x83>;
	};

	i2c4@11011000 {
		compatible = "mediatek,i2c";
		id = <0x04>;
		reg = <0x00 0x11011000 0x00 0x1000 0x00 0x11000400 0x00 0x180>;
		interrupts = <0x00 0x58 0x08>;
		clocks = <0x24 0x0b 0x24 0x26>;
		clock-names = "main\0dma";
		clock-div = <0x05>;
		scl-gpio-id = <0x69>;
		sda-gpio-id = <0x6a>;
		gpio_start = <0x10002800>;
		mem_len = <0x200>;
		eh_cfg = <0x20>;
		pu_cfg = <0x60>;
		rsel_cfg = <0xa0>;
		aed = <0x1a>;
		ch_offset_default = <0x100>;
		ch_offset_ccu = <0x200>;
		mediatek,hs_only;
		linux,phandle = <0x84>;
		phandle = <0x84>;
	};

	i2c5@11016000 {
		compatible = "mediatek,i2c";
		id = <0x05>;
		reg = <0x00 0x11016000 0x00 0x1000 0x00 0x11000580 0x00 0x80>;
		interrupts = <0x00 0x82 0x08>;
		clocks = <0x24 0x0b 0x24 0x26>;
		clock-names = "main\0dma";
		clock-div = <0x05>;
		scl-gpio-id = <0x30>;
		sda-gpio-id = <0x31>;
		gpio_start = <0x10002600>;
		mem_len = <0x200>;
		eh_cfg = <0x20>;
		pu_cfg = <0x90>;
		rsel_cfg = <0xb0>;
		aed = <0x1a>;
		mediatek,hs_only;
		linux,phandle = <0x85>;
		phandle = <0x85>;
	};

	i2c6@1100d000 {
		compatible = "mediatek,i2c";
		id = <0x06>;
		reg = <0x00 0x1100d000 0x00 0x1000 0x00 0x11000600 0x00 0x80>;
		interrupts = <0x00 0x83 0x08>;
		clocks = <0x24 0x0b 0x24 0x26>;
		clock-names = "main\0dma";
		clock-div = <0x05>;
		scl-gpio-id = <0xa1>;
		sda-gpio-id = <0xa2>;
		gpio_start = <0x10002c00>;
		mem_len = <0x200>;
		eh_cfg = <0x20>;
		pu_cfg = <0x50>;
		rsel_cfg = <0x70>;
		aed = <0x1a>;
		ch_offset_default = <0x100>;
		ch_offset_ccu = <0x200>;
		mediatek,hs_only;
		linux,phandle = <0x86>;
		phandle = <0x86>;
	};

	pwm@11006000 {
		compatible = "mediatek,pwm";
		reg = <0x00 0x11006000 0x00 0x10000>;
		interrupts = <0x00 0x4d 0x08>;
		clocks = <0x24 0x10 0x24 0x11 0x24 0x12 0x24 0x13 0x24 0x14 0x24 0x30 0x24 0x0f 0x24 0x15>;
		clock-names = "PWM1-main\0PWM2-main\0PWM3-main\0PWM4-main\0PWM5-main\0PWM6-main\0PWM-HCLK-main\0PWM-main";
		linux,phandle = <0x87>;
		phandle = <0x87>;
	};

	spi@1100a000 {
		compatible = "mediatek,mt6765-spi";
		mediatek,pad-select = <0x00>;
		reg = <0x00 0x1100a000 0x00 0x1000>;
		interrupts = <0x00 0x76 0x08>;
		clocks = <0x1e 0x0b 0x1e 0x6b 0x24 0x1b>;
		clock-names = "parent-clk\0sel-clk\0spi-clk";
		linux,phandle = <0x88>;
		phandle = <0x88>;
	};

	therm_ctrl@1100b000 {
		compatible = "mediatek,therm_ctrl";
		reg = <0x00 0x1100b000 0x00 0x1000>;
		interrupts = <0x00 0x4e 0x08>;
		clocks = <0x24 0x0a>;
		clock-names = "therm-main";
	};

	btif@1100c000 {
		compatible = "mediatek,btif";
		reg = <0x00 0x1100c000 0x00 0x1000 0x00 0x11000880 0x00 0x80 0x00 0x11000900 0x00 0x80>;
		interrupts = <0x00 0x70 0x08 0x00 0x84 0x08 0x00 0x85 0x08>;
		clocks = <0x24 0x1a 0x24 0x26>;
		clock-names = "btifc\0apdmac";
	};

	consys@18002000 {
		compatible = "mediatek,mt6765-consys";
		#address-cells = <0x02>;
		#size-cells = <0x02>;
		reg = <0x00 0x18002000 0x00 0x1000 0x00 0x10007000 0x00 0x100 0x00 0x10001000 0x00 0x1000 0x00 0x10006000 0x00 0x1000 0x00 0x18007000 0x00 0x1000 0x00 0x180b1000 0x00 0x1000 0x00 0x180a3000 0x00 0x1000 0x00 0x180a5000 0x00 0x800 0x00 0x180c1000 0x00 0x1000 0x00 0x18004000 0x00 0x1000 0x00 0x00 0x00 0x00 0x00 0x00 0x00 0x00 0x00 0x1020e000 0x00 0x1000>;
		interrupts = <0x00 0x10b 0x08 0x00 0x10d 0x08 0x00 0x10e 0x01>;
		clocks = <0x25 0x01>;
		clock-names = "conn";
		linux,phandle = <0x1b>;
		phandle = <0x1b>;
	};

	wifi@18000000 {
		compatible = "mediatek,wifi";
		reg = <0x00 0x18000000 0x00 0x100000>;
		interrupts = <0x00 0x10c 0x08>;
	};

	disp_pwm@1100e000 {
		compatible = "mediatek,disp_pwm";
		reg = <0x00 0x1100e000 0x00 0x1000>;
	};

	spi@11010000 {
		compatible = "mediatek,mt6765-spi";
		mediatek,pad-select = <0x00>;
		reg = <0x00 0x11010000 0x00 0x1000>;
		interrupts = <0x00 0x7a 0x08>;
		clocks = <0x1e 0x0b 0x1e 0x6b 0x24 0x34>;
		clock-names = "parent-clk\0sel-clk\0spi-clk";
		linux,phandle = <0x89>;
		phandle = <0x89>;
	};

	spi@11012000 {
		compatible = "mediatek,mt6765-spi";
		mediatek,pad-select = <0x00>;
		reg = <0x00 0x11012000 0x00 0x1000>;
		interrupts = <0x00 0x80 0x08>;
		clocks = <0x1e 0x0b 0x1e 0x6b 0x24 0x37>;
		clock-names = "parent-clk\0sel-clk\0spi-clk";
		linux,phandle = <0x8a>;
		phandle = <0x8a>;
	};

	spi@11013000 {
		compatible = "mediatek,mt6765-spi";
		mediatek,pad-select = <0x00>;
		reg = <0x00 0x11013000 0x00 0x1000>;
		interrupts = <0x00 0x81 0x08>;
		clocks = <0x1e 0x0b 0x1e 0x6b 0x24 0x38>;
		clock-names = "parent-clk\0sel-clk\0spi-clk";
		linux,phandle = <0x8b>;
		phandle = <0x8b>;
	};

	spi@11014000 {
		compatible = "mediatek,mt6765-spi";
		mediatek,pad-select = <0x00>;
		reg = <0x00 0x11014000 0x00 0x1000>;
		interrupts = <0x00 0x5f 0x08>;
		clocks = <0x1e 0x0b 0x1e 0x6b 0x24 0x41>;
		clock-names = "parent-clk\0sel-clk\0spi-clk";
		linux,phandle = <0x8c>;
		phandle = <0x8c>;
	};

	spi@11015000 {
		compatible = "mediatek,mt6765-spi";
		mediatek,pad-select = <0x00>;
		reg = <0x00 0x11015000 0x00 0x1000>;
		interrupts = <0x00 0x60 0x08>;
		clocks = <0x1e 0x0b 0x1e 0x6b 0x24 0x42>;
		clock-names = "parent-clk\0sel-clk\0spi-clk";
		linux,phandle = <0x8d>;
		phandle = <0x8d>;
	};

	imp_iic@11017000 {
		compatible = "mediatek,imp_iic";
		reg = <0x00 0x11017000 0x00 0x1000>;
	};

	nfi@11018000 {
		compatible = "mediatek,nfi";
		reg = <0x00 0x11018000 0x00 0x1000>;
	};

	nfiecc@11019000 {
		compatible = "mediatek,nfiecc";
		reg = <0x00 0x11019000 0x00 0x1000>;
	};

	usb0@11200000 {
		compatible = "mediatek,mt6765-usb20";
		reg = <0x00 0x11200000 0x00 0x10000 0x00 0x11cc0000 0x00 0x10000>;
		interrupts = <0x00 0x49 0x08>;
		mode = <0x02>;
		multipoint = <0x01>;
		num_eps = <0x10>;
		clocks = <0x24 0x08 0x1e 0x76 0x1e 0x20>;
		clock-names = "usb0\0usb0_clk_top_sel\0usb0_clk_univpll3_d4";
	};

	usb_sif@11210000 {
		compatible = "mediatek,usb_sif";
		reg = <0x00 0x11210000 0x00 0x10000>;
	};

	msdc@11230000 {
		compatible = "mediatek,msdc";
		reg = <0x00 0x11230000 0x00 0x10000>;
		interrupts = <0x00 0x4f 0x08>;
		index = [00];
		clk_src = [01];
		bus-width = <0x08>;
		max-frequency = <0xbebc200>;
		cap-mmc-highspeed;
		mmc-ddr-1_8v;
		mmc-hs200-1_8v;
		mmc-hs400-1_8v;
		no-sd;
		no-sdio;
		non-removable;
		pinctl = <0x32>;
		pinctl_hs400 = <0x33>;
		pinctl_hs200 = <0x34>;
		register_setting = <0x35>;
		host_function = [00];
		bootable;
		status = "okay";
		vmmc-supply = <0x36>;
		clocks = <0x24 0x4c 0x24 0x1c 0x24 0x44>;
		clock-names = "msdc0-clock\0msdc0-hclock\0msdc0-aes-clock";
		linux,phandle = <0x8e>;
		phandle = <0x8e>;
	};

	msdc@11240000 {
		compatible = "mediatek,msdc";
		reg = <0x00 0x11240000 0x00 0x10000>;
		interrupts = <0x00 0x50 0x08>;
		index = [01];
		clk_src = [02];
		bus-width = <0x04>;
		max-frequency = <0xbebc200>;
		cap-sd-highspeed;
		sd-uhs-sdr12;
		sd-uhs-sdr25;
		sd-uhs-sdr50;
		sd-uhs-sdr104;
		sd-uhs-ddr50;
		no-mmc;
		no-sdio;
		pinctl = <0x37>;
		pinctl_sdr104 = <0x38>;
		pinctl_sdr50 = <0x39>;
		pinctl_ddr50 = <0x3a>;
		register_setting = <0x3b>;
		host_function = [01];
		cd_level = [01];
		cd-gpios = <0x3c 0x00 0x00>;
		status = "okay";
		vmmc-supply = <0x3d>;
		vqmmc-supply = <0x3e>;
		clocks = <0x24 0x4d 0x24 0x1d>;
		clock-names = "msdc1-clock\0msdc1-hclock";
		linux,phandle = <0x8f>;
		phandle = <0x8f>;
	};

	msdc@11250000 {
		compatible = "mediatek,msdc2";
		reg = <0x00 0x11250000 0x00 0x10000>;
		status = "disable";
		linux,phandle = <0x90>;
		phandle = <0x90>;
	};

	msdc@11260000 {
		compatible = "mediatek,msdc3";
		reg = <0x00 0x11250000 0x00 0x10000>;
		status = "disable";
		linux,phandle = <0x91>;
		phandle = <0x91>;
	};

	msdc1_ins@0 {
		compatible = "mediatek,mt6765-sdcard-ins";
		linux,phandle = <0x92>;
		phandle = <0x92>;
	};

	msdc0_top@11cd0000 {
		compatible = "mediatek,msdc0_top";
		reg = <0x00 0x11cd0000 0x00 0x1000>;
	};

	msdc1_top@11c90000 {
		compatible = "mediatek,msdc1_top";
		reg = <0x00 0x11c90000 0x00 0x1000>;
	};

	usb1p_sif@11210000 {
		compatible = "mediatek,usb1p_sif";
		reg = <0x00 0x11210000 0x00 0x10000>;
	};

	audio@11220000 {
		compatible = "mediatek,audio\0syscon";
		reg = <0x00 0x11220000 0x00 0x1000>;
		#clock-cells = <0x01>;
		mediatek,btcvsd_snd = <0x3f>;
		linux,phandle = <0x40>;
		phandle = <0x40>;
	};

	mt_soc_dl1_pcm@11220000 {
		compatible = "mediatek,mt_soc_pcm_dl1";
		reg = <0x00 0x11220000 0x00 0x1000>;
		interrupts = <0x00 0x99 0x08>;
		clocks = <0x40 0x00 0x40 0x04 0x40 0x05 0x40 0x03 0x40 0x01 0x40 0x02 0x40 0x06 0x24 0x2b 0x24 0x33 0x1e 0x6f 0x1e 0x70 0x1e 0x03 0x1e 0x71 0x1e 0x29 0x1e 0x72 0x1e 0x2c 0x41 0x08 0x1f>;
		clock-names = "aud_afe_clk\0aud_dac_clk\0aud_dac_predis_clk\0aud_adc_clk\0aud_apll22m_clk\0aud_apll1_tuner_clk\0aud_tml_clk\0aud_infra_clk\0mtkaif_26m_clk\0top_mux_audio\0top_mux_audio_int\0top_sys_pll1_d4\0top_mux_aud_1\0top_apll1_ck\0top_mux_aud_eng1\0top_apll1_d8\0apmixed_apll1\0top_clk26m_clk";
		linux,phandle = <0x93>;
		phandle = <0x93>;
	};

	audio_sram@11221000 {
		compatible = "mediatek,audio_sram";
		reg = <0x00 0x11221000 0x00 0x9000>;
	};

	mtk-btcvsd-snd@18050000 {
		compatible = "mediatek,mtk-btcvsd-snd";
		reg = <0x00 0x18050000 0x00 0x1000 0x00 0x18080000 0x00 0x10000>;
		interrupts = <0x00 0x10a 0x08>;
		mediatek,infracfg = <0x24>;
		mediatek,offset = <0xf00 0x800 0x140 0x144 0x148>;
		linux,phandle = <0x3f>;
		phandle = <0x3f>;
	};

	mipi_rx_ana_csi0a@11c10000 {
		compatible = "mediatek,mipi_rx_ana_csi0a\0syscon";
		reg = <0x00 0x11c10000 0x00 0x1000>;
		#clock-cells = <0x01>;
		linux,phandle = <0x45>;
		phandle = <0x45>;
	};

	mipi_rx_ana_csi0b@11c11000 {
		compatible = "mediatek,mipi_rx_ana_csi0b\0syscon";
		reg = <0x00 0x11c11000 0x00 0x1000>;
		#clock-cells = <0x01>;
		linux,phandle = <0x46>;
		phandle = <0x46>;
	};

	mipi_rx_ana_csi1a@11c12000 {
		compatible = "mediatek,mipi_rx_ana_csi1a\0syscon";
		reg = <0x00 0x11c12000 0x00 0x1000>;
		#clock-cells = <0x01>;
		linux,phandle = <0x47>;
		phandle = <0x47>;
	};

	mipi_rx_ana_csi1b@11c13000 {
		compatible = "mediatek,mipi_rx_ana_csi1b\0syscon";
		reg = <0x00 0x11c13000 0x00 0x1000>;
		#clock-cells = <0x01>;
		linux,phandle = <0x48>;
		phandle = <0x48>;
	};

	mipi_rx_ana_csi2a@11c14000 {
		compatible = "mediatek,mipi_rx_ana_csi2a\0syscon";
		reg = <0x00 0x11c14000 0x00 0x1000>;
		#clock-cells = <0x01>;
		linux,phandle = <0x49>;
		phandle = <0x49>;
	};

	mipi_rx_ana_csi2b@11c15000 {
		compatible = "mediatek,mipi_rx_ana_csi2b\0syscon";
		reg = <0x00 0x11c15000 0x00 0x1000>;
		#clock-cells = <0x01>;
		linux,phandle = <0x4a>;
		phandle = <0x4a>;
	};

	efusec@11c50000 {
		compatible = "mediatek,efusec";
		reg = <0x00 0x11c50000 0x00 0x10000>;
	};

	mipi_tx0@11c80000 {
		compatible = "mediatek,mipi_tx0";
		reg = <0x00 0x11c80000 0x00 0x10000>;
	};

	msdc1_pad_macro@11c90000 {
		compatible = "mediatek,msdc1_pad_macro";
		reg = <0x00 0x11c90000 0x00 0x10000>;
	};

	msdc0_pad_macro@11cd0000 {
		compatible = "mediatek,msdc0_pad_macro";
		reg = <0x00 0x11cd0000 0x00 0x10000>;
	};

	mfg_doma@13000000 {
		compatible = "mediatek,doma";
		reg = <0x00 0x13000000 0x00 0x80000>;
		interrupts = <0x00 0x103 0x08>;
		interrupt-names = "RGX";
		clock-frequency = <0x21f98280>;
	};

	mfg_cfg@13ffe000 {
		compatible = "mediatek,mfgcfg\0syscon";
		reg = <0x00 0x13ffe000 0x00 0x1000>;
		#clock-cells = <0x01>;
		linux,phandle = <0x94>;
		phandle = <0x94>;
	};

	gpufreq {
		compatible = "mediatek,mt6765-gpufreq";
		clocks = <0x1e 0x64 0x1e 0x26 0x1f 0x25 0x08 0x25 0x04 0x25 0x07>;
		clock-names = "clk_mux\0clk_main_parent\0clk_sub_parent\0mtcmos_mfg_async\0mtcmos_mfg\0mtcmos_mfg_core0";
	};

	mmsys_config@14000000 {
		compatible = "mediatek,mmsys_config\0syscon";
		reg = <0x00 0x14000000 0x00 0x1000>;
		interrupts = <0x00 0xe3 0x08>;
		#clock-cells = <0x01>;
		clocks = <0x26 0x17 0x26 0x1a 0x26 0x1b>;
		clock-names = "CAM_MDP\0IMG_DL_RELAY\0IMG_DL_ASYNC_TOP";
		linux,phandle = <0x26>;
		phandle = <0x26>;
	};

	nfc {
		compatible = "mediatek,nfc-gpio-v2";
		gpio-rst = <0xac>;
		gpio-rst-std = <0x3c 0xac 0x00>;
		gpio-irq = <0x0a>;
		gpio-irq-std = <0x3c 0x0a 0x00>;
		linux,phandle = <0x95>;
		phandle = <0x95>;
	};

	irq_nfc {
		compatible = "mediatek,irq_nfc-eint";
		linux,phandle = <0x96>;
		phandle = <0x96>;
	};

	disp_mutex0@14001000 {
		compatible = "mediatek,disp_mutex0";
		reg = <0x00 0x14001000 0x00 0x1000>;
		interrupts = <0x00 0xd2 0x08>;
		linux,phandle = <0x2f>;
		phandle = <0x2f>;
	};

	smi_common@14002000 {
		compatible = "mediatek,smi_common";
		reg = <0x00 0x14002000 0x00 0x1000>;
		nr_larbs = <0x04>;
		larbs = <0x20 0x21 0x22 0x23>;
		mmsys_config = <0x26>;
		clocks = <0x25 0x03 0x26 0x15 0x26 0x16 0x26 0x13 0x1e 0x62 0x1e 0x21 0x1e 0x17 0x1e 0x22>;
		clock-names = "mtcmos-mm\0smi-common-gals-comm0\0smi-common-gals-comm1\0smi-common\0mmdvfs_clk_mm_sel_ck\0mmdvfs_clk_mmpll_ck\0mmdvfs_clk_univpll1_d2_ck\0mmdvfs_clk_mmpll_d2_ck";
	};

	mmdvfs_pmqos {
		compatible = "mediatek,mmdvfs_pmqos";
		mm_step0 = <0x1c9 0x01 0x00 0x01>;
		mm_step1 = <0x138 0x01 0x00 0x02>;
		mm_step2 = <0xe4 0x01 0x00 0x03>;
		vopp_steps = <0x00 0x01 0x03>;
		disp_freq = "mm_step0\0mm_step1\0mm_step2";
		mdp_freq = "mm_step0\0mm_step1\0mm_step2";
		cam_freq = "mm_step0\0mm_step1\0mm_step2";
		img_freq = "mm_step0\0mm_step1\0mm_step2";
		vdec_freq = "mm_step0\0mm_step1\0mm_step2";
		venc_freq = "mm_step0\0mm_step1\0mm_step2";
		clocks = <0x1e 0x62 0x1e 0x21 0x1e 0x17 0x1e 0x22>;
		clock-names = "mmdvfs_clk_mm_sel_ck\0mmdvfs_clk_mmpll_ck\0mmdvfs_clk_univpll1_d2_ck\0mmdvfs_clk_mmpll_d2_ck";
	};

	imgsys@15020000 {
		compatible = "mediatek,imgsys\0syscon";
		reg = <0x00 0x15020000 0x00 0x1000>;
		#clock-cells = <0x01>;
		clocks = <0x25 0x03 0x25 0x05 0x25 0x09 0x42 0x01 0x43 0x02 0x43 0x03 0x43 0x04 0x43 0x05 0x43 0x06 0x43 0x07>;
		clock-names = "ISP_SCP_SYS_DIS\0ISP_SCP_SYS_ISP\0ISP_SCP_SYS_CAM\0ISP_CLK_IMG_DIP\0ISP_CLK_CAM\0ISP_CLK_CAMTG\0ISP_CLK_CAM_SENINF\0ISP_CLK_CAMSV0\0ISP_CLK_CAMSV1\0ISP_CLK_CAMSV2";
		linux,phandle = <0x42>;
		phandle = <0x42>;
	};

	dip1@15022000 {
		compatible = "mediatek,dip1";
		reg = <0x00 0x15022000 0x00 0x3000>;
		interrupts = <0x00 0xff 0x08>;
	};

	dpe@15028000 {
		compatible = "mediatek,dpe";
		reg = <0x00 0x15028000 0x00 0x1000>;
		interrupts = <0x00 0x100 0x08>;
		clocks = <0x42 0x03>;
		clock-names = "DPE_CG_IMG_DPE";
	};

	smi_larb0@14003000 {
		cell-index = <0x00>;
		compatible = "mediatek,smi_larb0\0mediatek,smi_larb";
		reg = <0x00 0x14003000 0x00 0x1000>;
		clocks = <0x25 0x03 0x26 0x14>;
		clock-names = "mtcmos-mm\0mm-larb0";
		linux,phandle = <0x20>;
		phandle = <0x20>;
	};

	mdp_rdma0@14004000 {
		compatible = "mediatek,mdp_rdma0";
		reg = <0x00 0x14004000 0x00 0x1000>;
		interrupts = <0x00 0xd3 0x08>;
		clocks = <0x26 0x00>;
		clock-names = "MDP_RDMA0";
		linux,phandle = <0x27>;
		phandle = <0x27>;
	};

	mdp_ccorr0@14005000 {
		compatible = "mediatek,mdp_ccorr0";
		reg = <0x00 0x14005000 0x00 0x1000>;
		interrupts = <0x00 0xe2 0x08>;
		clocks = <0x26 0x01>;
		clock-names = "MDP_CCORR";
		linux,phandle = <0x2e>;
		phandle = <0x2e>;
	};

	mdp_rsz0@14006000 {
		compatible = "mediatek,mdp_rsz0";
		reg = <0x00 0x14006000 0x00 0x1000>;
		interrupts = <0x00 0xd4 0x08>;
		clocks = <0x26 0x02>;
		clock-names = "MDP_RSZ0";
		linux,phandle = <0x28>;
		phandle = <0x28>;
	};

	mdp_rsz1@14007000 {
		compatible = "mediatek,mdp_rsz1";
		reg = <0x00 0x14007000 0x00 0x1000>;
		interrupts = <0x00 0xd5 0x08>;
		clocks = <0x26 0x03>;
		clock-names = "MDP_RSZ1";
		linux,phandle = <0x29>;
		phandle = <0x29>;
	};

	mdp_wdma0@14008000 {
		compatible = "mediatek,mdp_wdma0";
		reg = <0x00 0x14008000 0x00 0x1000>;
		interrupts = <0x00 0xd8 0x08>;
		clocks = <0x26 0x06>;
		clock-names = "MDP_WDMA";
		linux,phandle = <0x2a>;
		phandle = <0x2a>;
	};

	mdp_wrot0@14009000 {
		compatible = "mediatek,mdp_wrot0";
		reg = <0x00 0x14009000 0x00 0x1000>;
		interrupts = <0x00 0xd7 0x08>;
		clocks = <0x26 0x05>;
		clock-names = "MDP_WROT0";
		linux,phandle = <0x2b>;
		phandle = <0x2b>;
	};

	mdp_tdshp0@1400a000 {
		compatible = "mediatek,mdp_tdshp0";
		reg = <0x00 0x1400a000 0x00 0x1000>;
		clocks = <0x26 0x04>;
		clock-names = "MDP_TDSHP";
		linux,phandle = <0x2c>;
		phandle = <0x2c>;
	};

	disp_ovl0@1400b000 {
		compatible = "mediatek,disp_ovl0";
		reg = <0x00 0x1400b000 0x00 0x1000>;
		interrupts = <0x00 0xd9 0x08>;
	};

	disp_ovl0_2l@1400c000 {
		compatible = "mediatek,disp_ovl0_2l";
		reg = <0x00 0x1400c000 0x00 0x1000>;
		interrupts = <0x00 0xe5 0x08>;
	};

	disp_rdma0@1400d000 {
		compatible = "mediatek,disp_rdma0";
		reg = <0x00 0x1400d000 0x00 0x1000>;
		interrupts = <0x00 0xda 0x08>;
	};

	disp_wdma0@1400e000 {
		compatible = "mediatek,disp_wdma0";
		reg = <0x00 0x1400e000 0x00 0x1000>;
		interrupts = <0x00 0xdb 0x08>;
	};

	disp_color0@1400f000 {
		compatible = "mediatek,disp_color0";
		reg = <0x00 0x1400f000 0x00 0x1000>;
		interrupts = <0x00 0xdc 0x08>;
		clocks = <0x26 0x0c>;
		clock-names = "MDP_COLOR";
		linux,phandle = <0x2d>;
		phandle = <0x2d>;
	};

	disp_ccorr0@14010000 {
		compatible = "mediatek,disp_ccorr0";
		reg = <0x00 0x14010000 0x00 0x1000>;
		interrupts = <0x00 0xdd 0x08>;
	};

	disp_aal0@14011000 {
		compatible = "mediatek,disp_aal0";
		reg = <0x00 0x14011000 0x00 0x1000>;
		interrupts = <0x00 0xde 0x08>;
	};

	disp_gamma0@14012000 {
		compatible = "mediatek,disp_gamma0";
		reg = <0x00 0x14012000 0x00 0x1000>;
		interrupts = <0x00 0xdf 0x08>;
	};

	disp_dither0@14013000 {
		compatible = "mediatek,disp_dither0";
		reg = <0x00 0x14013000 0x00 0x1000>;
		interrupts = <0x00 0xe0 0x08>;
	};

	dsi0@14014000 {
		compatible = "mediatek,dsi0";
		reg = <0x00 0x14014000 0x00 0x1000>;
		interrupts = <0x00 0xe1 0x08>;
	};

	disp_rsz0@14015000 {
		compatible = "mediatek,disp_rsz0";
		reg = <0x00 0x14015000 0x00 0x1000>;
		interrupts = <0x00 0x114 0x08>;
	};

	mtkfb@0 {
		compatible = "mediatek,mtkfb";
		linux,phandle = <0x97>;
		phandle = <0x97>;
	};

	dispsys {
		compatible = "mediatek,dispsys";
		mediatek,larb = <0x20>;
		clocks = <0x25 0x03 0x26 0x13 0x26 0x14 0x26 0x15 0x26 0x16 0x26 0x07 0x26 0x08 0x26 0x0a 0x26 0x0b 0x26 0x0c 0x26 0x0d 0x26 0x0e 0x26 0x0f 0x26 0x10 0x26 0x11 0x26 0x1c 0x26 0x1d 0x26 0x09 0x41 0x15 0x1e 0x73 0x24 0x31 0x1f 0x1e 0x1b 0x1e 0x2e 0x1e 0x30>;
		clock-names = "MMSYS_MTCMOS\0MMSYS_SMI_COMMON\0MMSYS_SMI_LARB0\0MMSYS_GALS_COMM0\0MMSYS_GALS_COMM1\0MMSYS_DISP_OVL0\0MMSYS_DISP_OVL0_2L\0MMSYS_DISP_RDMA0\0MMSYS_DISP_WDMA0\0MMSYS_DISP_COLOR0\0MMSYS_DISP_CCORR0\0MMSYS_DISP_AAL0\0MMSYS_DISP_GAMMA0\0MMSYS_DISP_DITHER0\0MMSYS_DSI0_MM_CK\0MMSYS_DSI0_IF_CK\0MMSYS_26M\0MMSYS_DISP_RSZ0\0APMIXED_MIPI_26M\0TOP_MUX_DISP_PWM\0DISP_PWM\0TOP_26M\0TOP_UNIVPLL2_D4\0TOP_ULPOSC1_D2\0TOP_ULPOSC1_D8";
	};

	dsi_te {
		compatible = "mediatek, DSI_TE-eint";
		status = "disabled";
		linux,phandle = <0x98>;
		phandle = <0x98>;
	};

	smi_larb2@15021000 {
		cell-index = <0x02>;
		compatible = "mediatek,smi_larb2\0mediatek,smi_larb";
		reg = <0x00 0x15021000 0x00 0x1000>;
		clocks = <0x25 0x05 0x26 0x18 0x42 0x00>;
		clock-names = "mtcmos-isp\0gals-img2mm\0img-larb2";
		linux,phandle = <0x22>;
		phandle = <0x22>;
	};

	fdvt@1502b000 {
		compatible = "mediatek,fdvt";
		reg = <0x00 0x1502b000 0x00 0x1000>;
		interrupts = <0x00 0x102 0x08>;
		clocks = <0x42 0x02>;
		clock-names = "FD_CLK_IMG_FDVT";
	};

	venc_gcon@17000000 {
		compatible = "mediatek,venc_gcon\0syscon";
		reg = <0x00 0x17000000 0x00 0x10000>;
		clocks = <0x25 0x03 0x25 0x0a 0x26 0x15 0x26 0x16 0x26 0x13 0x44 0x03 0x44 0x01>;
		clock-names = "MT_SCP_SYS_DIS\0MT_SCP_SYS_VCODEC\0MT_CG_MM_SMI_COMM0\0MT_CG_MM_SMI_COMM1\0MT_CG_MM_SMI_COMMON\0MT_CG_VDEC\0MT_CG_VENC";
		#clock-cells = <0x01>;
		linux,phandle = <0x44>;
		phandle = <0x44>;
	};

	smi_larb1@17010000 {
		cell-index = <0x01>;
		compatible = "mediatek,smi_larb1\0mediatek,smi_larb";
		reg = <0x00 0x17010000 0x00 0x1000>;
		clocks = <0x25 0x0a 0x44 0x01>;
		clock-names = "mtcmos-vcodec\0venc-larb1";
		linux,phandle = <0x21>;
		phandle = <0x21>;
	};

	venc@17020000 {
		compatible = "mediatek,venc";
		reg = <0x00 0x17020000 0x00 0x10000>;
		interrupts = <0x00 0xe6 0x08>;
	};

	venc_jpg@17030000 {
		compatible = "mediatek,venc_jpg";
		reg = <0x00 0x17030000 0x00 0x10000>;
		interrupts = <0x00 0xe8 0x08>;
		clocks = <0x44 0x02>;
		clock-names = "MT_CG_VENC_JPGENC";
	};

	vdec@17040000 {
		compatible = "mediatek,vdec";
		reg = <0x00 0x17040000 0x00 0x10000>;
		interrupts = <0x00 0xe9 0x08>;
	};

	mbist@17050000 {
		compatible = "mediatek,mbist";
		reg = <0x00 0x17050000 0x00 0x10000>;
	};

	camsys@1a000000 {
		compatible = "mediatek,camsys\0syscon";
		reg = <0x00 0x1a000000 0x00 0x1000>;
		#clock-cells = <0x01>;
		linux,phandle = <0x43>;
		phandle = <0x43>;
	};

	smi_larb3@1a002000 {
		cell-index = <0x03>;
		compatible = "mediatek,smi_larb3\0mediatek,smi_larb";
		reg = <0x00 0x1a002000 0x00 0x1000>;
		clocks = <0x25 0x09 0x26 0x19 0x43 0x00>;
		clock-names = "mtcmos-cam\0gals-cam2mm\0cam-larb3";
		linux,phandle = <0x23>;
		phandle = <0x23>;
	};

	cam1@1a003000 {
		compatible = "mediatek,cam1";
		reg = <0x00 0x1a003000 0x00 0x1000>;
		interrupts = <0x00 0xeb 0x08>;
	};

	cam2@1a004000 {
		compatible = "mediatek,cam2";
		reg = <0x00 0x1a004000 0x00 0x1000>;
		interrupts = <0x00 0xec 0x08>;
	};

	cam3@1a005000 {
		compatible = "mediatek,cam3";
		reg = <0x00 0x1a005000 0x00 0x1000>;
		interrupts = <0x00 0xed 0x08>;
	};

	cam_set@1a00b000 {
		compatible = "mediatek,cam_set";
		reg = <0x00 0x1a00b000 0x00 0x1000>;
	};

	cama_set@1a00c000 {
		compatible = "mediatek,cama_set";
		reg = <0x00 0x1a00c000 0x00 0x1000>;
	};

	camb_set@1a00d000 {
		compatible = "mediatek,camb_set";
		reg = <0x00 0x1a00d000 0x00 0x1000>;
	};

	cam_inner@1a013000 {
		compatible = "mediatek,cam_inner";
		reg = <0x00 0x1a013000 0x00 0x1000>;
	};

	cama_inner@1a014000 {
		compatible = "mediatek,cama_inner";
		reg = <0x00 0x1a014000 0x00 0x1000>;
	};

	camb_inner@1a015000 {
		compatible = "mediatek,camb_inner";
		reg = <0x00 0x1a015000 0x00 0x1000>;
	};

	cam_clear@1a01b000 {
		compatible = "mediatek,cam_clear";
		reg = <0x00 0x1a01b000 0x00 0x1000>;
	};

	cama_clear@1a01c000 {
		compatible = "mediatek,cama_clear";
		reg = <0x00 0x1a01c000 0x00 0x1000>;
	};

	camb_clear@1a01d000 {
		compatible = "mediatek,camb_clear";
		reg = <0x00 0x1a01d000 0x00 0x1000>;
	};

	cama_ext@1a024000 {
		compatible = "mediatek,cama_ext";
		reg = <0x00 0x1a024000 0x00 0x1000>;
	};

	camb_ext@1a025000 {
		compatible = "mediatek,camb_ext";
		reg = <0x00 0x1a025000 0x00 0x1000>;
	};

	seninf1@1a040000 {
		compatible = "mediatek,seninf1";
		reg = <0x00 0x1a040000 0x00 0x1000>;
	};

	seninf2@1a041000 {
		compatible = "mediatek,seninf2";
		reg = <0x00 0x1a041000 0x00 0x1000>;
	};

	seninf3@1a042000 {
		compatible = "mediatek,seninf3";
		reg = <0x00 0x1a042000 0x00 0x1000>;
	};

	seninf4@1a043000 {
		compatible = "mediatek,seninf4";
		reg = <0x00 0x1a043000 0x00 0x1000>;
	};

	kd_camera_hw1@1a040000 {
		compatible = "mediatek,camera_hw";
		reg = <0x00 0x1a040000 0x00 0x1000>;
		clocks = <0x1e 0x66 0x1e 0x67 0x1e 0x68 0x1e 0x69 0x1e 0x14 0x1e 0x13 0x1e 0x1d 0x1e 0x11 0x1e 0x1c 0x1e 0x12 0x1f 0x43 0x04 0x41 0x0e 0x41 0x12 0x45 0x00 0x46 0x00 0x47 0x00 0x48 0x00 0x49 0x00 0x4a 0x00 0x1e 0x7d 0x1e 0x1a 0x25 0x09>;
		clock-names = "CLK_TOP_CAMTG_SEL\0CLK_TOP_CAMTG1_SEL\0CLK_TOP_CAMTG2_SEL\0CLK_TOP_CAMTG3_SEL\0CLK_MCLK_6M\0CLK_MCLK_12M\0CLK_MCLK_13M\0CLK_MCLK_48M\0CLK_MCLK_52M\0CLK_MCLK_24M\0CLK_MCLK_26M\0CLK_CAM_SENINF_CG\0CLK_MIPI_C0_26M_CG\0CLK_MIPI_C1_26M_CG\0CLK_MIPI_ANA_0A_CG\0CLK_MIPI_ANA_0B_CG\0CLK_MIPI_ANA_1A_CG\0CLK_MIPI_ANA_1B_CG\0CLK_MIPI_ANA_2A_CG\0CLK_MIPI_ANA_2B_CG\0CLK_TOP_CAMTM_SEL_CG\0CLK_TOP_CAMTM_208_CG\0CLK_SCP_SYS_CAM";
		linux,phandle = <0x99>;
		phandle = <0x99>;
	};

	camsv1@1a050000 {
		compatible = "mediatek,camsv1";
		reg = <0x00 0x1a050000 0x00 0x1000>;
		interrupts = <0x00 0xf3 0x08>;
	};

	camsv2@1a051000 {
		compatible = "mediatek,camsv2";
		reg = <0x00 0x1a051000 0x00 0x1000>;
		interrupts = <0x00 0xf4 0x08>;
	};

	camsv3@1a052000 {
		compatible = "mediatek,camsv3";
		reg = <0x00 0x1a052000 0x00 0x1000>;
		interrupts = <0x00 0xf1 0x08>;
	};

	camsv4@1a053000 {
		compatible = "mediatek,camsv4";
		reg = <0x00 0x1a053000 0x00 0x1000>;
		interrupts = <0x00 0xf2 0x08>;
	};

	flashlight_core {
		compatible = "mediatek,flashlight_core";
		linux,phandle = <0x9a>;
		phandle = <0x9a>;
	};

	flashlights_ocp81391 {
		compatible = "mediatek,flashlights_ocp81391";
		linux,phandle = <0x9b>;
		phandle = <0x9b>;
	};

	flashlights_screen {
		compatible = "mediatek,flashlights_screen";
		linux,phandle = <0x9c>;
		phandle = <0x9c>;
	};

	gps {
		compatible = "mediatek,gps";
	};

	ccu@1a0b0000 {
		compatible = "mediatek,ccu";
		reg = <0x00 0x1a0b1000 0x00 0x1000>;
		interrupts = <0x00 0xf6 0x08>;
		clocks = <0x43 0x08 0x25 0x09>;
		clock-names = "CCU_CLK_CAM_CCU\0CAM_PWR";
	};

	mt6357_charger {
		compatible = "mediatek,mt6357_charger";
	};

	mt_charger {
		compatible = "mediatek,mt-charger";
		linux,phandle = <0x9d>;
		phandle = <0x9d>;
	};

	lk_charger {
		compatible = "mediatek,lk_charger";
		enable_anime;
		max_charger_voltage = <0x632ea0>;
		fast_charge_voltage = <0x2625a0>;
		usb_charger_current = <0x7a120>;
		ac_charger_current = <0x10eff0>;
		ac_charger_input_current = <0x10eff0>;
		non_std_ac_charger_current = <0x7ef40>;
		charging_host_charger_current = <0xf4240>;
		ta_ac_charger_current = <0x2dc6c0>;
		pd_charger_current = <0x7a120>;
		temp_t4_threshold = <0x32>;
		temp_t3_threshold = <0x2d>;
		temp_t1_threshold = <0x00>;
		linux,phandle = <0x9e>;
		phandle = <0x9e>;
	};

	charger {
		compatible = "mediatek,charger";
		algorithm_name = "LinearCharging";
		enable_sw_jeita;
		battery_cv = <0x432380>;
		max_charger_voltage = <0x632ea0>;
		min_charger_voltage = <0x4630c0>;
		usb_charger_current_suspend = <0x00>;
		usb_charger_current_unconfigured = <0x11170>;
		usb_charger_current_configured = <0x7ef40>;
		usb_charger_current = <0x7ef40>;
		ac_charger_current = <0x1cafc0>;
		ac_charger_input_current = <0x1cafc0>;
		non_std_ac_charger_current = <0x120160>;
		charging_host_charger_current = <0xf4240>;
		apple_1_0a_charger_current = <0x9eb10>;
		apple_2_1a_charger_current = <0xc3500>;
		ta_ac_charger_current = <0x2dc6c0>;
		jeita_temp_above_t4_cv = <0x3e8fa0>;
		jeita_temp_t3_to_t4_cv = <0x3e8fa0>;
		jeita_temp_t2_to_t3_cv = <0x432380>;
		jeita_temp_t1_to_t2_cv = <0x432380>;
		jeita_temp_t0_to_t1_cv = <0x432380>;
		jeita_temp_below_t0_cv = <0x432380>;
		temp_t4_thres = <0x37>;
		temp_t4_thres_minus_x_degree = <0x33>;
		temp_t3_thres = <0x2d>;
		temp_t3_thres_minus_x_degree = <0x2c>;
		temp_t2_thres = <0x0f>;
		temp_t2_thres_plus_x_degree = <0x10>;
		temp_t1_thres = <0x01>;
		temp_t1_thres_plus_x_degree = <0x01>;
		temp_t0_thres = <0x01>;
		temp_t0_thres_plus_x_degree = <0x01>;
		temp_neg_10_thres = <0x02>;
		enable_min_charge_temp;
		min_charge_temp = <0x00>;
		min_charge_temp_plus_x_degree = <0x01>;
		max_charge_temp = <0x35>;
		max_charge_temp_minus_x_degree = <0x34>;
		ta_12v_support;
		ta_9v_support;
		pe_ichg_level_threshold = <0xf4240>;
		ta_ac_12v_input_current = <0x30d400>;
		ta_ac_9v_input_current = <0x30d400>;
		ta_ac_7v_input_current = <0x30d400>;
		pe20_ichg_level_threshold = <0xf4240>;
		ta_start_battery_soc = <0x00>;
		ta_stop_battery_soc = <0x55>;
		pe40_single_charger_input_current = <0x2dc6c0>;
		pe40_single_charger_current = <0x2dc6c0>;
		pe40_dual_charger_input_current = <0x2dc6c0>;
		pe40_dual_charger_chg1_current = <0x1e8480>;
		pe40_dual_charger_chg2_current = <0x1e8480>;
		pe40_stop_battery_soc = <0x50>;
		pe40_r_cable_1a_lower = <0x229>;
		pe40_r_cable_2a_lower = <0x19f>;
		pe40_r_cable_3a_lower = <0x113>;
		chg1_ta_ac_charger_current = <0x16e360>;
		chg2_ta_ac_charger_current = <0x16e360>;
		cable_imp_threshold = <0x2bb>;
		vbat_cable_imp_threshold = <0x3b8260>;
		bif_threshold1 = <0x40d990>;
		bif_threshold2 = <0x419ce0>;
		bif_cv_under_threshold2 = <0x43e6d0>;
		enable_sw_safety_timer;
		max_charging_time = <0xa8c0>;
		recharge_offset = <0x186a0>;
		topoff_voltage = <0x401640>;
		chg_full_current = <0x30d40>;
		linux,phandle = <0x9f>;
		phandle = <0x9f>;
	};

	pd_adapter {
		compatible = "mediatek,pd_adapter";
		adapter_name = "pd_adapter";
		linux,phandle = <0xa0>;
		phandle = <0xa0>;
	};

	tran_battery {
		compatible = "tran,chg_fun";
		enable_pcb_tml;
		pcb_temp_step_one = <0xa028>;
		pcb_cur_step_one = <0xc8>;
		pcb_temp_step_two = <0xa7f8>;
		pcb_cur_step_two = <0x64>;
		pcb_min_chg_cur = <0x120160>;
		jeita_below_t0_chg_cur = <0x00>;
		jeita_t0_to_t1_chg_cur = <0xc3500>;
		jeita_t2_to_t3_chg_cur = <0x1cafc0>;
		jeita_t3_to_t4_chg_cur = <0x1cafc0>;
		jeita_above_t4_chg_cur = <0x00>;
		jeita_below_t0_input_cur = <0xc3500>;
		jeita_t0_to_t1_input_cur = <0xc3500>;
		jeita_t2_to_t3_input_cur = <0x1cafc0>;
		jeita_t3_to_t4_input_cur = <0x1cafc0>;
		jeita_above_t4_input_cur = <0xf4240>;
		jeita_above_t4_topoff_voltage = <0x3c45b0>;
		jeita_t3_to_t4_topoff_voltage = <0x3c45b0>;
		jeita_t2_to_t3_topoff_voltage = <0x401640>;
		jeita_t1_to_t2_topoff_voltage = <0x401640>;
		jeita_t0_to_t1_topoff_voltage = <0x401640>;
		jeita_below_t0_topoff_voltage = <0x401640>;
		linux,phandle = <0xa1>;
		phandle = <0xa1>;
	};

	irtx_pwm {
		compatible = "mediatek,irtx-pwm";
		pwm_ch = <0x00>;
		pwm_data_invert = <0x00>;
		linux,phandle = <0xa2>;
		phandle = <0xa2>;
	};

	odm {
		compatible = "simple-bus";
		linux,phandle = <0xa3>;
		phandle = <0xa3>;
	};

	memory-ssmr-features {
		compatible = "mediatek,memory-ssmr-features";
		svp-size = <0x00 0x10000000>;
		iris-recognition-size = <0x00 0x10000000>;
		2d_fr-size = <0x00 0x8000000>;
		tui-size = <0x00 0x4000000>;
		wfd-size = <0x00 0x4000000>;
		prot-sharedmem-size = <0x00 0x8000000>;
		ta-elf-size = <0x00 0x1000000>;
		ta-stack-heap-size = <0x00 0x6000000>;
		sdsp-tee-sharedmem-size = <0x00 0x1000000>;
		sdsp-firmware-size = <0x00 0x1000000>;
		linux,phandle = <0xa4>;
		phandle = <0xa4>;
	};

	audio_snd_card {
		compatible = "mediatek,audio_snd_card";
	};

	mt_soc_deep_buffer_dl_pcm {
		compatible = "mediatek,mt_soc_pcm_deep_buffer_dl";
	};

	mt_soc_ul1_pcm {
		compatible = "mediatek,mt_soc_pcm_capture";
	};

	mt_soc_voice_md1 {
		compatible = "mediatek,mt_soc_pcm_voice_md1";
	};

	mt_soc_uldlloopback_pcm {
		compatible = "mediatek,mt_soc_pcm_uldlloopback";
	};

	mt_soc_i2s0_pcm {
		compatible = "mediatek,mt_soc_pcm_dl1_i2s0";
	};

	mt_soc_mrgrx_pcm {
		compatible = "mediatek,mt_soc_pcm_mrgrx";
	};

	mt_soc_mrgrx_awb_pcm {
		compatible = "mediatek,mt_soc_pcm_mrgrx_awb";
	};

	mt_soc_fm_i2s_pcm {
		compatible = "mediatek,mt_soc_pcm_fm_i2s";
	};

	mt_soc_fm_i2s_awb_pcm {
		compatible = "mediatek,mt_soc_pcm_fm_i2s_awb";
	};

	mt_soc_i2s0dl1_pcm {
		compatible = "mediatek,mt_soc_pcm_dl1_i2s0dl1";
	};

	mt_soc_dl1_awb_pcm {
		compatible = "mediatek,mt_soc_pcm_dl1_awb";
	};

	mt_soc_voice_md1_bt {
		compatible = "mediatek,mt_soc_pcm_voice_md1_bt";
	};

	mt_soc_voip_bt_out {
		compatible = "mediatek,mt_soc_pcm_dl1_bt";
	};

	mt_soc_voip_bt_in {
		compatible = "mediatek,mt_soc_pcm_bt_dai";
	};

	mt_soc_tdmrx_pcm {
		compatible = "mediatek,mt_soc_tdm_capture";
	};

	mt_soc_fm_mrgtx_pcm {
		compatible = "mediatek,mt_soc_pcm_fmtx";
	};

	mt_soc_ul2_pcm {
		compatible = "mediatek,mt_soc_pcm_capture2";
	};

	mt_soc_i2s0_awb_pcm {
		compatible = "mediatek,mt_soc_pcm_i2s0_awb";
	};

	mt_soc_voice_md2 {
		compatible = "mediatek,mt_soc_pcm_voice_md2";
	};

	mt_soc_pcm_dl1_scp_spk {
		compatible = "mediatek,mt_soc_pcm_dl1_scp_spk";
	};

	mt_soc_pcm_voice_scp {
		compatible = "mediatek,mt_soc_pcm_voice_scp";
	};

	mt_soc_routing_pcm {
		compatible = "mediatek,mt_soc_pcm_routing";
	};

	mt_soc_voice_md2_bt {
		compatible = "mediatek,mt_soc_pcm_voice_md2_bt";
	};

	mt_soc_hp_impedance_pcm {
		compatible = "mediatek,mt_soc_pcm_hp_impedance";
	};

	mt_soc_codec_name {
		compatible = "mediatek,mt_soc_codec_63xx";
		use_hp_depop_flow = <0x00>;
		use_ul_260k = <0x00>;
	};

	mt_soc_dummy_pcm {
		compatible = "mediatek,mt_soc_pcm_dummy";
	};

	mt_soc_codec_dummy_name {
		compatible = "mediatek,mt_soc_codec_dummy";
	};

	mt_soc_routing_dai_name {
		compatible = "mediatek,mt_soc_dai_routing";
	};

	mt_soc_dai_name {
		compatible = "mediatek,mt_soc_dai_stub";
	};

	mt_soc_dl2_pcm {
		compatible = "mediatek,mt_soc_pcm_dl2";
	};

	mt_soc_anc_pcm {
		compatible = "mediatek,mt_soc_pcm_anc";
	};

	mt_soc_pcm_voice_ultra {
		compatible = "mediatek,mt_soc_pcm_voice_ultra";
	};

	mt_soc_pcm_voice_usb {
		compatible = "mediatek,mt_soc_pcm_voice_usb";
	};

	mt_soc_pcm_voice_usb_echoref {
		compatible = "mediatek,mt_soc_pcm_voice_usb_echoref";
	};

	pmic_clock_buffer_ctrl {
		compatible = "mediatek,pmic_clock_buffer";
		mediatek,clkbuf-quantity = <0x07>;
		mediatek,clkbuf-config = <0x02 0x01 0x01 0x02 0x00 0x00 0x00>;
		mediatek,clkbuf-driving-current = <0x01 0x01 0x01 0x01 0x01 0x01 0x01>;
		linux,phandle = <0xa5>;
		phandle = <0xa5>;
	};

	i2c7 {
		linux,phandle = <0xa6>;
		phandle = <0xa6>;
	};

	i2c8 {
		linux,phandle = <0xa7>;
		phandle = <0xa7>;
	};

	i2c9 {
		linux,phandle = <0xa8>;
		phandle = <0xa8>;
	};

	smart_pa {
		linux,phandle = <0xa9>;
		phandle = <0xa9>;
	};

	md1_sim1_hot_plug_eint {
		linux,phandle = <0xaa>;
		phandle = <0xaa>;
	};

	md1_sim2_hot_plug_eint {
		linux,phandle = <0xab>;
		phandle = <0xab>;
	};

	pseudo_m4u {
		compatible = "mediatek,mt-pseudo_m4u";
		iommus = <0x4b 0x02>;
	};

	pseudo_m4u-larb0 {
		compatible = "mediatek,mt-pseudo_m4u-port";
		mediatek,larbid = <0x00>;
		iommus = <0x4b 0x00 0x4b 0x01 0x4b 0x02 0x4b 0x03 0x4b 0x04 0x4b 0x05 0x4b 0x06 0x4b 0x07>;
	};

	pseudo_m4u-larb1 {
		compatible = "mediatek,mt-pseudo_m4u-port";
		mediatek,larbid = <0x01>;
		iommus = <0x4b 0x20 0x4b 0x21>;
	};

	pseudo_m4u-larb2 {
		compatible = "mediatek,mt-pseudo_m4u-port";
		mediatek,larbid = <0x02>;
		iommus = <0x4b 0x40 0x4b 0x41>;
	};

	pseudo_m4u-larb3 {
		compatible = "mediatek,mt-pseudo_m4u-port";
		mediatek,larbid = <0x03>;
		iommus = <0x4b 0x60 0x4b 0x61>;
	};

	eas {
		eff_turn_point = <0x1d3>;
		tiny = <0x32>;
	};

	radio_md_cfg {
		compatible = "mediatek,radio_md_cfg";
		linux,phandle = <0xac>;
		phandle = <0xac>;
	};

	dynamic_options {
		compatible = "mediatek,dynamic_options";
		linux,phandle = <0xad>;
		phandle = <0xad>;
	};

	mt6370_pmu_dts {
		interrupt-controller;
		#interrupt-cells = <0x01>;
		mt6370,intr_gpio_num = <0x03>;
		mt6370,intr_gpio = <0x3c 0x03 0x00>;
		linux,phandle = <0xae>;
		phandle = <0xae>;

		core {
			compatible = "mediatek,mt6370_pmu_core";
			interrupt-names = "otp\0vdda_ovp\0vdda_uv";
			i2cstmr_rst_tmr = <0x00>;
			mrstb_en;
			mrstb_tmr = <0x03>;
			int_wdt = <0x00>;
			int_deg = <0x00>;
		};

		charger {
			compatible = "mediatek,mt6370_pmu_charger";
			interrupt-names = "chg_mivr\0chg_aiclmeasi\0attachi\0ovpctrl_uvp_d_evt\0chg_wdtmri\0chg_vbusov\0chg_tmri\0chg_treg";
			charger_name = "primary_chg";
			load_switch_name = "primary_load_switch";
			ichg = <0x1e8480>;
			aicr = <0x7a120>;
			mivr = <0x432380>;
			cv = <0x426030>;
			ieoc = <0x249f0>;
			safety_timer = <0x0c>;
			dc_wdt = <0x3d0900>;
			ircmp_resistor = <0x61a8>;
			ircmp_vclamp = <0x7d00>;
			enable_te;
			enable_wdt;
		};

		mt6370_pmu_fled1 {
			compatible = "mediatek,mt6370_pmu_fled1";
			interrupt-names = "fled_lvf\0fled2_short\0fled1_short";
			fled_enable = <0x01>;
			torch_cur = <0x493e0>;
			strobe_cur = <0x124f80>;
			strobe_timeout = <0x960>;
		};

		mt6370_pmu_fled2 {
			compatible = "mediatek,mt6370_pmu_fled2";
			fled_enable = <0x01>;
			torch_cur = <0x30d40>;
			strobe_cur = <0xf4240>;
			strobe_timeout = <0x4b0>;
		};

		ldo {
			compatible = "mediatek,mt6370_pmu_ldo";
			interrupt-names = "ldo_oc";
			ldo_oms = <0x01>;
			ldo_vrc_lt = <0x01>;

			mt6370_ldo {
				regulator-name = "irtx_ldo";
				regulator-min-microvolt = <0x186a00>;
				regulator-max-microvolt = <0x3d0900>;
			};
		};

		rgbled {
			compatible = "mediatek,mt6370_pmu_rgbled";
			interrupt-names = "isink4_short\0isink3_short\0isink2_short\0isink1_short\0isink4_open\0isink3_open\0isink2_open\0isink1_open";
			mt,led_name = "mt6370_pmu_led1\0mt6370_pmu_led2\0mt6370_pmu_led3\0mt6370_pmu_led4";
			mt,led_default_trigger = "cc_mode\0cc_mode\0cc_mode\0none";
		};

		bled {
			compatible = "mediatek,mt6370_pmu_bled";
			interrupt-names = "bled_ocp";
			mt,bled_name = "mt6370_pmu_bled";
			mt,chan_en = <0x0f>;
			mt,map_linear;
			mt,bl_ovp_level = <0x03>;
			mt,bl_ocp_level = <0x02>;
			mt,use_pwm;
			mt,pwm_fsample = <0x02>;
			mt,pwm_deglitch = <0x01>;
			mt,pwm_hys_en = <0x01>;
			mt,pwm_hys = <0x00>;
			mt,pwm_avg_cycle = <0x00>;
			mt,bled_ramptime = <0x03>;
			mt,bled_flash_ramp = <0x01>;
			mt,max_bled_brightness = <0x200>;
		};

		dsv {
			compatible = "mediatek,mt6370_pmu_dsv";
			interrupt-names = "dsv_vneg_ocp\0dsv_vpos_ocp\0dsv_bst_ocp\0dsv_vneg_scp\0dsv_vpos_scp";
			db_ext_en = <0x00>;
			db_periodic_fix = <0x00>;
			db_single_pin = <0x00>;
			db_freq_pm = <0x00>;
			db_periodic_mode = <0x00>;
			db_startup = <0x00>;
			db_vneg_20ms = <0x01>;
			db_vneg_disc = <0x00>;
			db_vpos_20ms = <0x01>;
			db_vpos_disc = <0x01>;
			db_delay = <0x03>;
			db_vbst = <0x1644>;
			db_vpos_slew = <0x01>;
			db_vneg_slew = <0x01>;

			mt6370_dsvp {
				regulator-name = "dsv_pos";
				regulator-min-microvolt = <0x3d0900>;
				regulator-max-microvolt = <0x5b8d80>;
			};

			mt6370_dsvn {
				regulator-name = "dsv_neg";
				regulator-min-microvolt = <0x3d0900>;
				regulator-max-microvolt = <0x5b8d80>;
			};
		};
	};

	type_c_port0 {
		tcpc-dual,supported_modes = <0x00>;
		mt-tcpc,name = "type_c_port0";
		mt-tcpc,role_def = <0x04>;
		mt-tcpc,rp_level = <0x00>;
		mt-tcpc,vconn_supply = <0x01>;
		mt6370pd,intr_gpio = <0x3c 0x18 0x00>;
		mt6370pd,intr_gpio_num = <0x18>;
		linux,phandle = <0xaf>;
		phandle = <0xaf>;

		pd-data {
			pd,vid = <0x29cf>;
			pd,pid = <0x5081>;
			pd,source-cap-ext = <0x171129cf 0x00 0x102 0x00 0x00 0x2000000>;
			pd,mfrs = "RichtekTCPC";
			pd,charging_policy = <0x21>;
			pd,source-pdo-size = <0x01>;
			pd,source-pdo-data = <0x19032>;
			pd,sink-pdo-size = <0x02>;
			pd,sink-pdo-data = <0x190c8 0xc0761e3c>;
			pd,id-vdo-size = <0x03>;
			pd,id-vdo-data = <0xd10029cf 0x00 0x10000>;
			bat,nr = <0x01>;
			pd,country_nr = <0x00>;

			bat-info0 {
				bat,vid = <0x29cf>;
				bat,pid = <0x1711>;
				bat,mfrs = "bat1";
				bat,design_cap = <0xbb8>;
			};
		};

		dpm_caps {
			local_dr_power;
			local_dr_data;
			local_usb_comm;
			local_no_suspend;
			local_vconn_supply;
			attemp_enter_dp_mode;
			attemp_discover_cable;
			attemp_discover_id;
			pr_check = <0x00>;
			pr_check_gp_source;
			dr_check = <0x00>;
		};
	};

	__symbols__ {
		chosen = "/chosen";
		cpu0 = "/cpus/cpu@000";
		cpu1 = "/cpus/cpu@001";
		cpu2 = "/cpus/cpu@002";
		cpu3 = "/cpus/cpu@003";
		cpu4 = "/cpus/cpu@100";
		cpu5 = "/cpus/cpu@101";
		cpu6 = "/cpus/cpu@102";
		cpu7 = "/cpus/cpu@103";
		STANDBY = "/cpus/idle-states/standby";
		MCDI_CPU = "/cpus/idle-states/mcdi-cpu";
		MCDI_CLUSTER = "/cpus/idle-states/mcdi-cluster";
		SODI = "/cpus/idle-states/sodi";
		SODI3 = "/cpus/idle-states/sodi3";
		DPIDLE = "/cpus/idle-states/dpidle";
		SUSPEND = "/cpus/idle-states/suspend";
		reserved_memory = "/reserved-memory";
		cpu_dbgapb = "/cpu_dbgapb@0d410000";
		gic = "/interrupt-controller@0c000000";
		sysirq = "/intpol-controller@10200a80";
		infracfg_ao = "/infracfg_ao@10001000";
		scpsys = "/scpsys@10001000";
		topckgen = "/topckgen@10000000";
		syscfg_pctl_1 = "/syscfg_pctl_1@0x10002000";
		syscfg_pctl_2 = "/syscfg_pctl_2@0x10002200";
		syscfg_pctl_3 = "/syscfg_pctl_3@0x10002400";
		syscfg_pctl_4 = "/syscfg_pctl_4@0x10002600";
		syscfg_pctl_5 = "/syscfg_pctl_5@0x10002800";
		syscfg_pctl_6 = "/syscfg_pctl_6@0x10002a00";
		syscfg_pctl_7 = "/syscfg_pctl_7@0x10002c00";
		pericfg = "/pericfg@10003000";
		gpio_usage_mapping = "/gpio";
		gpio = "/gpio@10005000";
		syscfg_pctl_0 = "/syscfg_pctl_0@10005000";
		pio = "/pinctrl@1000b000";
		msdc0_pins_default = "/pinctrl@1000b000/msdc0@default";
		msdc0_pins_hs400 = "/pinctrl@1000b000/msdc0@hs400";
		msdc0_pins_hs200 = "/pinctrl@1000b000/msdc0@hs200";
		msdc0_register_setting_default = "/pinctrl@1000b000/msdc0@register_default";
		msdc1_pins_default = "/pinctrl@1000b000/msdc1@default";
		msdc1_pins_sdr104 = "/pinctrl@1000b000/msdc1@sdr104";
		msdc1_pins_sdr50 = "/pinctrl@1000b000/msdc1@sdr50";
		msdc1_pins_ddr50 = "/pinctrl@1000b000/msdc1@ddr50";
		msdc1_register_setting_default = "/pinctrl@1000b000/msdc1@register_default";
		msdc3_pins_default = "/pinctrl@1000b000/msdc3@default";
		msdc3_register_setting_default = "/pinctrl@1000b000/msdc3@register_default";
		clk26m = "/clocks/clk26m";
		clk32k = "/clocks/clk32k";
		apmixed = "/apmixed@1000c000";
		main_pmic = "/mt-pmic";
		pmic_auxadc = "/mt-pmic/mt635x-auxadc";
		mt_pmic_vs1_buck_reg = "/mt-pmic/buck_regulators/buck_vs1";
		mt_pmic_vmodem_buck_reg = "/mt-pmic/buck_regulators/buck_vmodem";
		mt_pmic_vcore_buck_reg = "/mt-pmic/buck_regulators/buck_vcore";
		mt_pmic_vproc_buck_reg = "/mt-pmic/buck_regulators/buck_vproc";
		mt_pmic_vpa_buck_reg = "/mt-pmic/buck_regulators/buck_vpa";
		mt_pmic_vfe28_ldo_reg = "/mt-pmic/ldo_regulators/ldo_vfe28";
		mt_pmic_vxo22_ldo_reg = "/mt-pmic/ldo_regulators/ldo_vxo22";
		mt_pmic_vrf18_ldo_reg = "/mt-pmic/ldo_regulators/ldo_vrf18";
		mt_pmic_vrf12_ldo_reg = "/mt-pmic/ldo_regulators/ldo_vrf12";
		mt_pmic_vefuse_ldo_reg = "/mt-pmic/ldo_regulators/ldo_vefuse";
		mt_pmic_vcn33_bt_ldo_reg = "/mt-pmic/ldo_regulators/ldo_vcn33_bt";
		mt_pmic_vcn33_wifi_ldo_reg = "/mt-pmic/ldo_regulators/ldo_vcn33_wifi";
		mt_pmic_vcn28_ldo_reg = "/mt-pmic/ldo_regulators/ldo_vcn28";
		mt_pmic_vcn18_ldo_reg = "/mt-pmic/ldo_regulators/ldo_vcn18";
		mt_pmic_vcama_ldo_reg = "/mt-pmic/ldo_regulators/ldo_vcama";
		mt_pmic_vcamd_ldo_reg = "/mt-pmic/ldo_regulators/ldo_vcamd";
		mt_pmic_vcamio_ldo_reg = "/mt-pmic/ldo_regulators/ldo_vcamio";
		mt_pmic_vldo28_ldo_reg = "/mt-pmic/ldo_regulators/ldo_vldo28";
		mt_pmic_vsram_others_ldo_reg = "/mt-pmic/ldo_regulators/ldo_vsram_others";
		mt_pmic_vsram_proc_ldo_reg = "/mt-pmic/ldo_regulators/ldo_vsram_proc";
		mt_pmic_vaux18_ldo_reg = "/mt-pmic/ldo_regulators/ldo_vaux18";
		mt_pmic_vaud28_ldo_reg = "/mt-pmic/ldo_regulators/ldo_vaud28";
		mt_pmic_vio28_ldo_reg = "/mt-pmic/ldo_regulators/ldo_vio28";
		mt_pmic_vio18_ldo_reg = "/mt-pmic/ldo_regulators/ldo_vio18";
		mt_pmic_vdram_ldo_reg = "/mt-pmic/ldo_regulators/ldo_vdram";
		mt_pmic_vmc_ldo_reg = "/mt-pmic/ldo_regulators/ldo_vmc";
		mt_pmic_vmch_ldo_reg = "/mt-pmic/ldo_regulators/ldo_vmch";
		mt_pmic_vemc_ldo_reg = "/mt-pmic/ldo_regulators/ldo_vemc";
		mt_pmic_vsim1_ldo_reg = "/mt-pmic/ldo_regulators/ldo_vsim1";
		mt_pmic_vsim2_ldo_reg = "/mt-pmic/ldo_regulators/ldo_vsim2";
		mt_pmic_vibr_ldo_reg = "/mt-pmic/ldo_regulators/ldo_vibr";
		mt_pmic_vusb33_ldo_reg = "/mt-pmic/ldo_regulators/ldo_vusb33";
		keypad = "/kp@10010000";
		otg_iddig = "/otg_iddig";
		mrdump_ext_rst = "/mrdump_ext_rst";
		touch = "/touch";
		stepmotor = "/stepmotor";
		accdet = "/accdet";
		goodix_fp = "/fingerprint";
		bat_gm30 = "/battery";
		iommu = "/m4u@10205000";
		mdcldma = "/mdcldma@10014000";
		gce = "/gce@10238000";
		gce_mbox = "/gce_mbox@10238000";
		gce_mbox_svp = "/gce_mbox_svp@10238000";
		auxadc = "/auxadc@11001000";
		apdma = "/dma-controller@11000580";
		uart0 = "/serial@11020000";
		uart1 = "/serial@11030000";
		i2c_common = "/i2c_common";
		i2c0 = "/i2c0@11007000";
		i2c1 = "/i2c1@11008000";
		i2c2 = "/i2c2@11009000";
		i2c3 = "/i2c3@1100f000";
		i2c4 = "/i2c4@11011000";
		i2c5 = "/i2c5@11016000";
		i2c6 = "/i2c6@1100d000";
		pwm = "/pwm@11006000";
		spi0 = "/spi@1100a000";
		consys = "/consys@18002000";
		spi1 = "/spi@11010000";
		spi2 = "/spi@11012000";
		spi3 = "/spi@11013000";
		spi4 = "/spi@11014000";
		spi5 = "/spi@11015000";
		msdc0 = "/msdc@11230000";
		msdc1 = "/msdc@11240000";
		msdc2 = "/msdc@11250000";
		msdc3 = "/msdc@11260000";
		msdc1_ins = "/msdc1_ins@0";
		audio = "/audio@11220000";
		audgpio = "/mt_soc_dl1_pcm@11220000";
		btcvsd_snd = "/mtk-btcvsd-snd@18050000";
		mipi_rx_ana_csi0a = "/mipi_rx_ana_csi0a@11c10000";
		mipi_rx_ana_csi0b = "/mipi_rx_ana_csi0b@11c11000";
		mipi_rx_ana_csi1a = "/mipi_rx_ana_csi1a@11c12000";
		mipi_rx_ana_csi1b = "/mipi_rx_ana_csi1b@11c13000";
		mipi_rx_ana_csi2a = "/mipi_rx_ana_csi2a@11c14000";
		mipi_rx_ana_csi2b = "/mipi_rx_ana_csi2b@11c15000";
		mfg_cfg = "/mfg_cfg@13ffe000";
		mmsys_config = "/mmsys_config@14000000";
		nfc = "/nfc";
		irq_nfc = "/irq_nfc";
		disp_mutex0 = "/disp_mutex0@14001000";
		imgsys = "/imgsys@15020000";
		smi_larb0 = "/smi_larb0@14003000";
		mdp_rdma0 = "/mdp_rdma0@14004000";
		mdp_ccorr = "/mdp_ccorr0@14005000";
		mdp_rsz0 = "/mdp_rsz0@14006000";
		mdp_rsz1 = "/mdp_rsz1@14007000";
		mdp_wdma0 = "/mdp_wdma0@14008000";
		mdp_wrot0 = "/mdp_wrot0@14009000";
		mdp_tdshp0 = "/mdp_tdshp0@1400a000";
		disp_color0 = "/disp_color0@1400f000";
		mtkfb = "/mtkfb@0";
		dsi_te = "/dsi_te";
		smi_larb2 = "/smi_larb2@15021000";
		venc_gcon = "/venc_gcon@17000000";
		smi_larb1 = "/smi_larb1@17010000";
		camsys = "/camsys@1a000000";
		smi_larb3 = "/smi_larb3@1a002000";
		kd_camera_hw1 = "/kd_camera_hw1@1a040000";
		flashlight_core = "/flashlight_core";
		flashlights_ocp81391 = "/flashlights_ocp81391";
		flashlights_screen = "/flashlights_screen";
		mt_charger = "/mt_charger";
		lk_charger = "/lk_charger";
		charger = "/charger";
		pd_adapter = "/pd_adapter";
		tran_battery = "/tran_battery";
		irtx_pwm = "/irtx_pwm";
		odm = "/odm";
		memory_ssmr_features = "/memory-ssmr-features";
		pmic_clock_buffer_ctrl = "/pmic_clock_buffer_ctrl";
		i2c7 = "/i2c7";
		i2c8 = "/i2c8";
		i2c9 = "/i2c9";
		smart_pa = "/smart_pa";
		md1_sim1_hot_plug_eint = "/md1_sim1_hot_plug_eint";
		md1_sim2_hot_plug_eint = "/md1_sim2_hot_plug_eint";
		radio_md_cfg = "/radio_md_cfg";
		dynamic_options = "/dynamic_options";
		mt6370_pmu = "/mt6370_pmu_dts";
		mt6370_typec = "/type_c_port0";
	};
};
